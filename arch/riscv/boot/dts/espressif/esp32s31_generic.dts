// SPDX-License-Identifier: GPL-2.0+
/*
 * ESP32-S31 Device Tree Source
 */
/dts-v1/;
#include "esp32s31.dtsi"

/ {
	model = "Espressif ESP32-S31 S-mode (generic)";
	compatible = "espressif,esp32s31";

	chosen {
		stdout-path = "serial0:115200n8";

		opensbi-config {
			compatible = "opensbi,config";
			/* Match the U-Boot control FDT used for OpenSBI initialization. */
			heap-size = <0x4000>;
		};
	};
};

&systimer { status = "okay"; };
