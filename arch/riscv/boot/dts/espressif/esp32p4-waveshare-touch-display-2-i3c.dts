// SPDX-License-Identifier: (GPL-2.0-only OR BSD-2-Clause)
#include "esp32p4-waveshare-touch-display-2.dts"

&p4_pinctrl {
	pins_i3c_master: i3c-master-pins {
		function = "i3c-master";
	};
};

&{/soc} {
	/* TRM ch.50 I3C master, ch.14 I3C_MST_INTR source 101. */
	i3c0: i3c@500da000 {
		compatible = "espressif,esp32p4-i3c";
		reg = <0x500da000 0x200>;
		interrupt-parent = <&{/soc/interrupt-controller@20800000}>;
		interrupts = <101 4>;
		clocks = <&periphclk ESP32P4_CLK_I3C>;
		resets = <&periphclk ESP32P4_RST_I3C>;
		pinctrl-names = "default";
		pinctrl-0 = <&pins_i3c_master>;
		i3c-scl-hz = <10000000>;
		#address-cells = <3>;
		#size-cells = <0>;
	};
};
