// SPDX-License-Identifier: GPL-2.0+

/dts-v1/;
#include "esp32s31-wroom-3.dtsi"
#include "esp32s31-coreboard.dtsi"

/ {
	model = "Espressif ESP32-S31-Function-CoreBoard-1";
	compatible = "espressif,esp32s31-function-coreboard-1", "espressif,esp32s31";
};
