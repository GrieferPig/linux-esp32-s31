// SPDX-License-Identifier: GPL-2.0+
/dts-v1/;
/plugin/;

/ {
	espressif,overlay-name = "sdmmc0";
	espressif,resource-claims = "sdmmc-host";
	espressif,gpio-claims = <20 21 22 23 24 25>;
};

&sdmmc {
	espressif,slot-id = <0>;
	pinctrl-0 = <&sdmmc0_default>;
	status = "okay";
};
