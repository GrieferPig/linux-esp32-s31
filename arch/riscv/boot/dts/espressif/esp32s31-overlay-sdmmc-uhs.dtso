// SPDX-License-Identifier: GPL-2.0+
/dts-v1/;
/plugin/;

/ {
	espressif,overlay-name = "sdmmc-uhs";
	espressif,resource-claims = "sdmmc-host";
	espressif,gpio-claims = <20 21 22 23 24 25>;
};

&sdmmc {
	espressif,slot-id = <0>;
	espressif,param-name = "bus-width";
	espressif,param-values = <1 4>;
	pinctrl-0 = <&sdmmc0_default>;
	bus-width = <4>;
	cap-sd-highspeed;
	sd-uhs-sdr12;
	sd-uhs-sdr25;
	sd-uhs-sdr50;
	max-frequency = <100000000>;
	status = "okay";
};
