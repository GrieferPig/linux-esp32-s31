// SPDX-License-Identifier: (GPL-2.0-only OR BSD-2-Clause)

/dts-v1/;
#include "esp32p4.dtsi"
#include "esp32p4-16m.dtsi"

/ {
	model = "Espressif ESP32-P4 v1.3 (generic)";
	compatible = "espressif,esp32p4-generic", "espressif,esp32p4";
};
