// SPDX-License-Identifier: GPL-2.0-only OR BSD-2-Clause
#include "esp32p4-waveshare-touch-display-2.dts"

/* TRM ch.46 UHCI_CONF0.UART_SEL and ch.6 AHB GDMA peripheral request 2. */
&uart4 {
	compatible = "espressif,esp32p4-uhci-uart";
	reg = <0x500ce000 0x1000>, <0x500df000 0x100>;
	reg-names = "uart", "uhci";
	/delete-property/ interrupt-parent;
	/delete-property/ interrupts;
	clocks = <&periphclk ESP32P4_CLK_UART4>, <&periphclk ESP32P4_CLK_UHCI>;
	clock-names = "uart", "bus";
	resets = <&periphclk ESP32P4_RST_UART4>, <&periphclk ESP32P4_RST_UHCI>;
	reset-names = "uart", "uhci";
	dmas = <&ahb_dma 2 2>;
	dma-names = "tx";
	status = "okay";
};

/* Pair 2 is dedicated to UHCI. Keep the ADC's LP one-shot controller. */
&{/soc/adc@50127000} {
	reg = <0x50127000 0x100>;
	/delete-property/ reg-names;
	/delete-property/ clocks;
	/delete-property/ resets;
	/delete-property/ dmas;
	/delete-property/ dma-names;
};
