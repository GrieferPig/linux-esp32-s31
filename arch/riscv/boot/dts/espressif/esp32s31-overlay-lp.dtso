// SPDX-License-Identifier: GPL-2.0-only OR BSD-2-Clause
/dts-v1/;
/plugin/;

#include <dt-bindings/interrupt-controller/irq.h>

/ {
	espressif,overlay-name = "lp";
	espressif,resource-claims = "lp-core";

	fragment@0 {
		target-path = "/soc/remoteproc@2e000000";

		__overlay__ {
			status = "okay";
		};
	};
};
