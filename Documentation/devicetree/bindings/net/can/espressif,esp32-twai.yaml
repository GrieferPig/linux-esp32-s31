## Documentation/devicetree/bindings/watchdog/espressif,esp32-timg-wdt.yaml
```yaml
# SPDX-License-Identifier: (GPL-2.0-only OR BSD-2-Clause)
%YAML 1.2
---
$id: http://devicetree.org/schemas/watchdog/espressif,esp32-timg-wdt.yaml#
$schema: http://devicetree.org/meta-schemas/core.yaml#

title: Espressif ESP32 timer-group main watchdogs

maintainers:
  - Espressif Linux Port Maintainers <linux-riscv@espressif.com>

allOf:
  - $ref: watchdog.yaml#
  - if:
      properties:
        compatible:
          const: espressif,esp32s31-timg-wdt
    then:
      properties:
        resets:
          maxItems: 1
      required:
        - resets

properties:
  compatible:
    enum:
      - espressif,esp32p4-timg-wdt
      - espressif,esp32s31-timg-wdt

  reg:
    maxItems: 1
    description: Watchdog register window starting at TIMG_WDTCONFIG0.

  clocks:
    maxItems: 1
    description: Timer-group watchdog clock derived from the 40 MHz crystal.

required:
  - compatible
  - reg
  - clocks

unevaluatedProperties: false
```

## Documentation/devicetree/bindings/watchdog/espressif,esp32p4-timg-wdt.yaml
```yaml
# SPDX-License-Identifier: (GPL-2.0-only OR BSD-2-Clause)
%YAML 1.2
---
$id: http://devicetree.org/schemas/watchdog/espressif,esp32p4-timg-wdt.yaml#
$schema: http://devicetree.org/meta-schemas/core.yaml#

title: Espressif ESP32-P4 timer-group main watchdogs

maintainers:
  - Espressif Linux Port Maintainers <linux-riscv@espressif.com>

allOf:
  - $ref: watchdog.yaml#

properties:
  compatible:
    const: espressif,esp32p4-timg-wdt

  reg:
    maxItems: 1
    description: Watchdog register window starting at TIMG_WDTCONFIG0.

  clocks:
    maxItems: 1
    description: Timer-group watchdog clock derived from the 40 MHz crystal.

required:
  - compatible
  - reg
  - clocks

unevaluatedProperties: false
```

## arch/riscv/configs/esp32p4_reconstructed_defconfig
```kconfig
# Independent reconstruction. Original v4 IKCONFIG was not embedded.
CONFIG_EXPERT=y
CONFIG_ARCH_RV32I=y
# CONFIG_MMU is not set
CONFIG_RISCV_M_MODE=y
CONFIG_ARCH_ESPRESSIF=y
CONFIG_SOC_ESP32P4=y
CONFIG_NONPORTABLE=y
CONFIG_SMP=y
CONFIG_NR_CPUS=2
CONFIG_RISCV_BOOT_SPINWAIT=y
CONFIG_PHYS_RAM_BASE_FIXED=y
CONFIG_PHYS_RAM_BASE=0x48000000
CONFIG_FPU=y
CONFIG_RISCV_ISA_C=y
# CONFIG_RISCV_ISA_V is not set
# CONFIG_RISCV_ISA_ZAWRS is not set
# CONFIG_RISCV_ISA_ZBA is not set
# CONFIG_RISCV_ISA_ZBB is not set
# CONFIG_RISCV_ISA_ZBKB is not set
# CONFIG_RISCV_ISA_ZICBOZ is not set
CONFIG_RISCV_SLOW_UNALIGNED_ACCESS=y
CONFIG_CC_OPTIMIZE_FOR_SIZE=y
CONFIG_PREEMPT_NONE=y
CONFIG_HZ_100=y
CONFIG_HIGH_RES_TIMERS=y
CONFIG_PRINTK_TIME=y
CONFIG_BINFMT_FLAT=y
# CONFIG_BINFMT_ELF is not set
CONFIG_BLK_DEV_INITRD=y
CONFIG_RD_GZIP=y
CONFIG_INITRAMFS_COMPRESSION_GZIP=y
CONFIG_DEVTMPFS=y
CONFIG_DEVTMPFS_MOUNT=y
CONFIG_PROC_FS=y
CONFIG_SYSFS=y
CONFIG_TTY=y
CONFIG_VT=y
CONFIG_VT_CONSOLE=y
CONFIG_SERIAL_ESP32=y
CONFIG_SERIAL_ESP32_ACM=y
CONFIG_SERIAL_CORE=y
CONFIG_SERIAL_EARLYCON=y
CONFIG_SERIAL_CORE_CONSOLE=y
CONFIG_FB=y
CONFIG_FRAMEBUFFER_CONSOLE=y
CONFIG_FB_ESP32P4=y
CONFIG_FB_ESP32P4_DSI=y
CONFIG_FONT_8x16=y
CONFIG_I2C=y
CONFIG_I2C_ESPRESSIF=y
CONFIG_GPIOLIB=y
CONFIG_INPUT_EVDEV=y
CONFIG_INPUT_TOUCHSCREEN=y
CONFIG_TOUCHSCREEN_GOODIX=y
CONFIG_BLOCK=y
CONFIG_MMC=y
CONFIG_MMC_BLOCK=y
CONFIG_PWRSEQ_SIMPLE=y
CONFIG_MMC_DW=y
CONFIG_MMC_DW_PLTFM=y
CONFIG_REGULATOR_ESP32P4_VO4=y
CONFIG_REGULATOR_ESP32S31_ANA_I2C=y
CONFIG_IIO=y
CONFIG_ESP32P4_LP_ADC=y
CONFIG_USB=y
CONFIG_USB_DWC2=y
CONFIG_USB_DWC2_DUAL_ROLE=y
CONFIG_USB_GADGET=y
CONFIG_USB_CONFIGFS=y
CONFIG_USB_CONFIGFS_ACM=y
CONFIG_PHY_ESP32P4_USB=y
CONFIG_SCSI=y
CONFIG_BLK_DEV_SD=y
CONFIG_USB_STORAGE=y
CONFIG_NET=y
CONFIG_INET=y
CONFIG_PACKET=y
CONFIG_UNIX=y
CONFIG_NETDEVICES=y
CONFIG_NET_VENDOR_STMICRO=y
CONFIG_STMMAC_ETH=y
CONFIG_STMMAC_PLATFORM=y
CONFIG_DWMAC_ESP32P4=y
CONFIG_ICPLUS_PHY=y
CONFIG_NVMEM=y
CONFIG_NVMEM_ESP32P4_EFUSE=y
CONFIG_SOUND=y
CONFIG_SND=y
CONFIG_SND_SOC=y
CONFIG_SND_SOC_ESP32S31_I2S=y
CONFIG_SND_SOC_ES8311=y
CONFIG_SND_SOC_SIMPLE_AMPLIFIER=y
CONFIG_SND_SIMPLE_CARD=y
CONFIG_WATCHDOG=y
CONFIG_WATCHDOG_SYSFS=y
CONFIG_ESP32P4_WATCHDOG=y
CONFIG_COUNTER=y
CONFIG_ESP32S31_GPTIMER=y
CONFIG_ESP32S31_SYSTEM_TIMERS=y
CONFIG_ESP32S31_PCNT=y
CONFIG_SENSORS_ESP32S31_TSENS=y
CONFIG_PWM_ESP32S31_LEDC=y
CONFIG_PWM_ESP32S31_MCPWM=y
CONFIG_RC_CORE=m
CONFIG_LIRC=y
CONFIG_RC_DEVICES=y
CONFIG_IR_ESP32P4_RMT=m
CONFIG_CRYPTO_DEV_ESP32P4=y
CONFIG_CAN=y
CONFIG_CAN_RAW=y
CONFIG_CAN_DEV=y
CONFIG_CAN_SJA1000=y
CONFIG_CAN_ESP32P4_TWAI=y
CONFIG_DMADEVICES=y
CONFIG_ESPRESSIF_GDMA_AHB=y
CONFIG_ESPRESSIF_DMA2D=y
CONFIG_ESPRESSIF_GDMA_AXI=y
CONFIG_WLAN=y
CONFIG_CFG80211=y
CONFIG_BT=y
# CONFIG_BT_BREDR is not set
CONFIG_BT_LE=y
CONFIG_MODULES=y
CONFIG_MODULE_UNLOAD=y
# CONFIG_PM is not set
# CONFIG_SUSPEND is not set
# CONFIG_HOTPLUG_CPU is not set
# CONFIG_KEXEC is not set
# CONFIG_KEXEC_FILE is not set
# CONFIG_KALLSYMS is not set
# CONFIG_RANDOMIZE_BASE is not set
# CONFIG_VIRTUALIZATION is not set
# CONFIG_COREDUMP is not set
# CONFIG_SLUB_DEBUG is not set
CONFIG_SLUB_TINY=y
CONFIG_BASE_SMALL=y
CONFIG_IKCONFIG=y
CONFIG_IKCONFIG_PROC=y
CONFIG_LOCALVERSION="-p4-reconstructed"
# CONFIG_LOCALVERSION_AUTO is not set
CONFIG_DEBUG_INFO_DWARF4=y

CONFIG_BACKLIGHT_CLASS_DEVICE=y
CONFIG_BACKLIGHT_ESPRESSIF_TOUCH_DISPLAY2=y


CONFIG_MEDIA_SUPPORT=y
CONFIG_MEDIA_SUPPORT_FILTER=y
CONFIG_MEDIA_CAMERA_SUPPORT=y
CONFIG_VIDEO_DEV=y
CONFIG_MEDIA_PLATFORM_SUPPORT=y
CONFIG_MEDIA_PLATFORM_DRIVERS=y
# CONFIG_MEDIA_SUBDRV_AUTOSELECT is not set
CONFIG_VIDEO_ESPRESSIF_CSI=y

CONFIG_REGULATOR=y
CONFIG_REGULATOR_FIXED_VOLTAGE=y
CONFIG_REGULATOR_RASPBERRYPI_TOUCHSCREEN_V2=y
CONFIG_PWM=y
CONFIG_BACKLIGHT_PWM=y
```

## drivers/media/platform/espressif/Kconfig
```kconfig
config VIDEO_ESPRESSIF_CSI
	bool "ESP32-P4 CSI/ISP with OV5647"
	depends on SOC_ESP32P4 && I2C && VIDEO_DEV && !MMU
	select VIDEOBUF2_CORE
	select VIDEOBUF2_V4L2
	select VIDEOBUF2_MEMOPS
	help
	  IRQ-driven RGB565 capture using the ESP32-P4 Linux CSI, ISP and VDMA
	  drivers with an OV5647 on the Waveshare 15-pin CSI connector.

config VIDEO_ESP32P4_PPA
	bool "ESP32-P4 Pixel Processing Accelerator"
	depends on SOC_ESP32P4 && VIDEO_DEV && ESPRESSIF_DMA2D=y
	select V4L2_MEM2MEM_DEV
	select VIDEOBUF2_DMA_CONTIG
	select VIDEOBUF2_V4L2
	help
	  V4L2 memory-to-memory RGB565 scaling, rotation and mirroring
	  through the ESP32-P4 PPA and 2D DMA.

config VIDEO_ESP32P4_JPEG
	bool "ESP32-P4 JPEG encoder and decoder"
	depends on SOC_ESP32P4 && VIDEO_DEV && ESPRESSIF_DMA2D=y
	select V4L2_JPEG_HELPER
	select V4L2_MEM2MEM_DEV
	select VIDEOBUF2_DMA_CONTIG
	select VIDEOBUF2_V4L2
	help
	  Encode and decode baseline JPEG images (grayscale and color)
	  through the ESP32-P4 JPEG codec and 2D DMA using V4L2 M2M.

config VIDEO_ESP32P4_LCDCAM
	bool "ESP32-P4 LCD_CAM parallel LCD and DVP camera capture"
	depends on SOC_ESP32P4 && VIDEO_DEV && ESPRESSIF_GDMA_AXI
	select VIDEOBUF2_DMA_CONTIG
	select VIDEOBUF2_V4L2
	help
	  Parallel RGB/I80 LCD output and V4L2 DVP camera capture through
	  the ESP32-P4 LCD_CAM controller and AXI-GDMA.

config VIDEO_ESP32P4_ISP
	bool "ESP32-P4 ISP control interface"
	depends on SOC_ESP32P4 && VIDEO_DEV
	help
	  V4L2 control and statistics interface (color, CCM, BF, sharpen,
	  AWB, AE) for the ESP32-P4 Image Signal Processor.

config VIDEO_ESP32P4_H264
	bool "ESP32-P4 H.264 hardware encoder"
	depends on SOC_ESP32P4 && VIDEO_DEV
	select V4L2_MEM2MEM_DEV
	select VIDEOBUF2_DMA_CONTIG
	select VIDEOBUF2_V4L2
	help
	  V4L2 memory-to-memory H.264 baseline encoder through the
	  ESP32-P4 H.264 core and dedicated H264 2D-DMA.

config VIDEO_ESP32S31_JPEG
	tristate "ESP32-S31 JPEG encoder and decoder"
	depends on SOC_ESP32S31 && VIDEO_DEV && ESPRESSIF_DMA2D
	select V4L2_JPEG_HELPER
	select V4L2_MEM2MEM_DEV
	select VIDEOBUF2_DMA_CONTIG
	select VIDEOBUF2_V4L2
	help
	  Encode and decode baseline JPEG images (grayscale and color)
	  through the ESP32-S31 JPEG codec and 2D-DMA using V4L2 M2M.

config VIDEO_ESP32S31_PPA
	tristate "ESP32-S31 Pixel Processing Accelerator"
	depends on SOC_ESP32S31 && VIDEO_DEV && ESPRESSIF_DMA2D
	select V4L2_MEM2MEM_DEV
	select VIDEOBUF2_DMA_CONTIG
	select VIDEOBUF2_V4L2
	help
	  V4L2 memory-to-memory scaling, rotation, mirroring (SRM), solid fill,
	  and alpha blending through the ESP32-S31 PPA and 2D-DMA.

config VIDEO_ESP32S31_CAM
	tristate "ESP32-S31 LCD_CAM DVP camera capture"
	depends on SOC_ESP32S31 && VIDEO_DEV && ESPRESSIF_GDMA_AXI
	select VIDEOBUF2_DMA_CONTIG
	select VIDEOBUF2_V4L2
	help
	  V4L2 video capture driver for the ESP32-S31 LCD_CAM parallel DVP
	  camera receiver using AXI-GDMA.
```
