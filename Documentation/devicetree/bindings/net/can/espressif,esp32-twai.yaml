## Documentation/devicetree/bindings/pinctrl/espressif,esp32-pinctrl.yaml
```yaml
# SPDX-License-Identifier: (GPL-2.0-only OR BSD-2-Clause)
%YAML 1.2
---
$id: http://devicetree.org/schemas/pinctrl/espressif,esp32-pinctrl.yaml#
$schema: http://devicetree.org/meta-schemas/core.yaml#

title: Espressif ESP32 pin controllers

maintainers:
  - Max Filippov <jcmvbkbc@gmail.com>
  - GrieferPig <noreply@example.com>

description: |
  ESP32-S31 has 60 bonded GPIO pads in the GPIO0 through GPIO61 number
  space. GPIO29 and GPIO41 are unbonded. Each pad has an IO_MUX function
  selector and can also connect to peripheral inputs and outputs through the
  GPIO matrix. The controller provides GPIO data, direction, pad electrical
  configuration and per-pin interrupts through four aggregate outputs. This
  binding uses aggregate output zero.

  Pin configuration nodes are children of a pinctrl state node. Their pinmux
  property consists of cells built with ESP32S31_IOMUX(),
  ESP32S31_IOMUX_IN(), ESP32S31_MATRIX_IN(), ESP32S31_MATRIX_OUT(), or
  ESP32S31_GPIO() from
  dt-bindings/pinctrl/esp32s31-pinmux.h. A group may mix those cell types and
  may contain both input and output routes for bidirectional peripherals.

properties:
  compatible:
    enum:
      - espressif,esp32s31-pinctrl
      - waveshare,esp32p4-wifi6-dev-kit-peripheral-pinctrl

  gpio-controller: true

  '#gpio-cells':
    const: 2

  gpio-reserved-ranges: true

required:
  - compatible
  - reg

oneOf:
  - properties:
      compatible:
        const: espressif,esp32s31-pinctrl

      reg:
        minItems: 3
        maxItems: 3

      reg-names:
        items:
          - const: gpio
          - const: iomux
          - const: cnnt-pad-ctrl

      interrupt-controller: true

      '#interrupt-cells':
        const: 2

      interrupts:
        maxItems: 1

    required:
      - reg
      - reg-names
      - interrupt-controller
      - '#interrupt-cells'
      - interrupts

    patternProperties:
      '-pins$':
        type: object
        additionalProperties: false
        patternProperties:
          '(-pins|-pads|-signals|-in|-out|-capture|-fault|-sync)$|^(outputs|loopback-inputs|rx|tx)$':
            type: object
            additionalProperties: false

            properties:
              pinmux:
                $ref: /schemas/types.yaml#/definitions/uint32-array
                minItems: 1
                maxItems: 124
                description: Encoded IO_MUX and GPIO matrix operations.

              espressif,route-name:
                $ref: /schemas/types.yaml#/definitions/string
                description: User-visible name of a scalar configurable GPIO route.
              espressif,route-kind:
                $ref: /schemas/types.yaml#/definitions/string
                description: Hardware route class for the scalar route.
                enum: [matrix-input, matrix-output, matrix-bidirectional]
              espressif,route-names:
                $ref: /schemas/types.yaml#/definitions/string-array
                description: Configurable route name for each pinmux entry.
                minItems: 1
                maxItems: 124
              espressif,route-kinds:
                $ref: /schemas/types.yaml#/definitions/non-unique-string-array
                description: Hardware route class for each pinmux entry.
                minItems: 1
                maxItems: 124
                items:
                  enum: [matrix-input, matrix-output, matrix-bidirectional]

              bias-disable: true
              bias-pull-up: true
              bias-pull-down: true
              input-enable: true
              input-disable: true
              input-schmitt-enable: true
              input-debounce:
                $ref: /schemas/types.yaml#/definitions/uint32-array
                maxItems: 1
                description: A nonzero value enables the fixed hardware glitch filter.
              drive-open-drain: true
              drive-push-pull: true
              drive-strength:
                $ref: /schemas/types.yaml#/definitions/uint32
                enum: [5, 10, 20, 40]
                description: Approximate pad drive strength in mA.
              output-disable: true
              output-high: true
              output-low: true

            required:
              - pinmux
  - properties:
      compatible:
        const: waveshare,esp32p4-wifi6-dev-kit-peripheral-pinctrl

      reg:
        oneOf:
          - items:
              - description: HP GPIO matrix
              - description: HP IO MUX pads
          - items:
              - description: HP GPIO matrix
              - description: HP IO MUX pads
              - description: LP GPIO matrix
              - description: LP IO MUX pads

      clocks:
        maxItems: 1
        description: IOMUX clock

      gpio-controller: true

      '#gpio-cells':
        const: 2

      gpio-ranges:
        maxItems: 1

    required:
      - reg
      - clocks

    patternProperties:
      '^(i2c[01]|gpspi[23]|sdmmc[01]|emac-(rmii|mdio)|i2s[0-2]|pcnt0|ledc0|mcpwm[01]|rmt-loopback|twai[0-2]-loopback|adc1-header|lp-(i2c|spi|uart)|uart[1-4]|usbfs-device|i3c-(master|legacy)|parlio-loopback)-pins$':
        type: object
        properties:
          function:
            $ref: /schemas/types.yaml#/definitions/string
            enum: [i2c0, i2c1, gpspi2, gpspi3, sdmmc0, sdmmc1, emac-rmii,
                   emac-mdio, i2s0, i2s1, i2s2, pcnt0, ledc0, mcpwm0,
                   mcpwm1, rmt-loopback, twai0-loopback, twai1-loopback,
                   twai2-loopback, adc1-header, lp-i2c, lp-spi, lp-uart,
                   uart1, uart2, uart3, uart4, usbfs-device, i3c-master,
                   i3c-legacy, parlio-loopback]
        required:
          - function
        additionalProperties: false

unevaluatedProperties: false

examples:
  - |
    #include <dt-bindings/gpio/gpio.h>
    #include <dt-bindings/interrupt-controller/irq.h>
    #include <dt-bindings/pinctrl/esp32s31-pinmux.h>

    pinctrl@20583000 {
        compatible = "espressif,esp32s31-pinctrl";
        reg = <0x20583000 0x1000>, <0x20582000 0x1000>,
              <0x20588000 0x1000>;
        reg-names = "gpio", "iomux", "cnnt-pad-ctrl";
        gpio-controller;
        #gpio-cells = <2>;
        interrupt-controller;
        #interrupt-cells = <2>;
        interrupts = <18 61 IRQ_TYPE_LEVEL_HIGH>;

        uart-pins {
            tx-pins {
                pinmux = <ESP32S31_MATRIX_OUT(20, 10, 0)>;
                drive-strength = <20>;
            };
            rx-pins {
                pinmux = <ESP32S31_MATRIX_IN(21, 10, 0)>;
                bias-pull-up;
                input-enable;
            };
        };
    };
```

## Documentation/devicetree/bindings/pinctrl/waveshare,esp32p4-wifi6-dev-kit-peripheral-pinctrl.yaml
```yaml
# SPDX-License-Identifier: (GPL-2.0-only OR BSD-2-Clause)
%YAML 1.2
---
$id: http://devicetree.org/schemas/pinctrl/waveshare,esp32p4-wifi6-dev-kit-peripheral-pinctrl.yaml#
$schema: http://devicetree.org/meta-schemas/core.yaml#

title: Waveshare ESP32-P4-WIFI6-DEV-KIT rev1 peripheral pin groups

maintainers:
  - GrieferPig <noreply@example.com>

description: |
  Board pin groups for I2C1, GPSPI2, SDMMC, Ethernet, I2S0 and PCNT on the ESP32-P4
  hw_ver1 GPIO matrix and IO MUX. Board-owned GPIO ranges may be exported.

properties:
  compatible:
    const: waveshare,esp32p4-wifi6-dev-kit-peripheral-pinctrl

  reg:
    items:
      - description: GPIO matrix
      - description: IO_MUX pads

  clocks:
    maxItems: 1
    description: IOMUX clock

  gpio-controller: true

  '#gpio-cells':
    const: 2

  gpio-ranges:
    maxItems: 1

  gpio-reserved-ranges: true

patternProperties:
  '^(i2c1|gpspi2|sdmmc0|sdmmc1|emac-rmii|emac-mdio|i2s0|pcnt0|ledc0|mcpwm0|mcpwm1|rmt-loopback|twai[0-2]-loopback)-pins$':
    type: object
    properties:
      function:
        enum: [i2c1, gpspi2, sdmmc0, sdmmc1, emac-rmii, emac-mdio, i2s0, pcnt0, ledc0,
               mcpwm0, mcpwm1, rmt-loopback, twai0-loopback, twai1-loopback,
               twai2-loopback]
    required:
      - function
    additionalProperties: false

required:
  - compatible
  - reg
  - clocks

additionalProperties: false
```

## Documentation/devicetree/bindings/regulator/espressif,esp32p4-vo4-bypass.yaml
```yaml
# SPDX-License-Identifier: (GPL-2.0-only OR BSD-2-Clause)
%YAML 1.2
---
$id: http://devicetree.org/schemas/regulator/espressif,esp32p4-vo4-bypass.yaml#
$schema: http://devicetree.org/meta-schemas/core.yaml#

title: ESP32-P4 VO4 regulator in 3.3 V bypass mode

maintainers:
  - GrieferPig <noreply@example.com>

allOf:
  - $ref: regulator.yaml#

properties:
  compatible:
    const: espressif,esp32p4-vo4-bypass

  reg:
    maxItems: 1
    description: VO4 control register in the power management unit

  regulator-min-microvolt:
    const: 3300000

  regulator-max-microvolt:
    const: 3300000

required:
  - compatible
  - reg
  - regulator-name
  - regulator-min-microvolt
  - regulator-max-microvolt

unevaluatedProperties: false
```

## Documentation/devicetree/bindings/serial/espressif,esp32-uhci-uart.yaml
```yaml
# SPDX-License-Identifier: (GPL-2.0-only OR BSD-2-Clause)
%YAML 1.2
---
$id: http://devicetree.org/schemas/serial/espressif,esp32-uhci-uart.yaml#
$schema: http://devicetree.org/meta-schemas/core.yaml#

title: Espressif ESP32 HP UART with UHCI DMA

maintainers:
  - Espressif Linux Port Maintainers <linux-riscv@espressif.com>

description: |
  One UHCI bridge connects to a selected HP UART.
  The serial alias number selects the corresponding hardware UART. A single
  AHB GDMA pair services both transmit and receive for the bridge.

allOf:
  - $ref: serial.yaml#
  - if:
      properties:
        compatible:
          const: espressif,esp32p4-uhci-uart
    then:
      properties:
        reg:
          items:
            - description: HP UART registers
            - description: UHCI bridge registers
        reg-names:
          items:
            - const: uart
            - const: uhci
      required:
        - resets
        - reset-names
    else:
      properties:
        reg:
          items:
            - description: HP UART registers
            - description: UHCI bridge registers
            - description: UHCI clock and reset register
            - description: DMA buffers in internal SRAM
        reg-names:
          items:
            - const: uart
            - const: uhci
            - const: clkrst
            - const: dma-buf
        resets: false
        reset-names: false

properties:
  compatible:
    enum:
      - espressif,esp32p4-uhci-uart
      - espressif,esp32s31-uhci-uart

  clocks:
    items:
      - description: UART APB and functional clock
      - description: UHCI bus clock

  clock-names:
    items:
      - const: uart
      - const: bus

  resets:
    items:
      - description: HP UART reset
      - description: UHCI bridge reset

  reset-names:
    items:
      - const: uart
      - const: uhci

  dmas:
    maxItems: 1
    description: AHB GDMA pair with UHCI0 trigger selector.

  dma-names:
    const: tx

  espressif,irda-mode:
    type: boolean
    description: Enable the HP UART IrDA encoder and decoder.

required:
  - compatible
  - reg
  - reg-names
  - clocks
  - clock-names
  - dmas
  - dma-names

unevaluatedProperties: false
```

## Documentation/devicetree/bindings/serial/espressif,esp32p4-uhci-uart.yaml
```yaml
# SPDX-License-Identifier: (GPL-2.0-only OR BSD-2-Clause)
%YAML 1.2
---
$id: http://devicetree.org/schemas/serial/espressif,esp32p4-uhci-uart.yaml#
$schema: http://devicetree.org/meta-schemas/core.yaml#

title: Espressif ESP32-P4 HP UART with UHCI DMA

maintainers:
  - Espressif Linux Port Maintainers <linux-riscv@espressif.com>

description: |
  The ESP32-P4 has one UHCI bridge, selectable to one of the five HP UARTs.
  The serial alias number selects the corresponding hardware UART. A single
  AHB GDMA pair services both transmit and receive for the bridge.

allOf:
  - $ref: serial.yaml#

properties:
  compatible:
    const: espressif,esp32p4-uhci-uart

  reg:
    items:
      - description: HP UART registers
      - description: UHCI bridge registers

  reg-names:
    items:
      - const: uart
      - const: uhci

  clocks:
    items:
      - description: UART APB and functional clock
      - description: UHCI bus clock

  clock-names:
    items:
      - const: uart
      - const: bus

  resets:
    items:
      - description: HP UART reset
      - description: UHCI bridge reset

  reset-names:
    items:
      - const: uart
      - const: uhci

  dmas:
    maxItems: 1
    description: AHB GDMA pair with UHCI0 trigger selector.

  dma-names:
    const: tx

  espressif,irda-mode:
    type: boolean
    description: Enable the HP UART IrDA encoder and decoder.

required:
  - compatible
  - reg
  - reg-names
  - clocks
  - clock-names
  - resets
  - reset-names
  - dmas
  - dma-names

unevaluatedProperties: false
```

## Documentation/devicetree/bindings/spi/espressif,esp32s31-gpspi.yaml
```yaml
# SPDX-License-Identifier: (GPL-2.0-only OR BSD-2-Clause)
%YAML 1.2
---
$id: http://devicetree.org/schemas/spi/espressif,esp32s31-gpspi.yaml#
$schema: http://devicetree.org/meta-schemas/core.yaml#

title: Espressif ESP32-S31 and ESP32-P4 general-purpose SPI controllers

maintainers:
  - Espressif Linux Port Maintainers <linux-riscv@espressif.com>

description: |
  The S31 controller can switch between host and target through runtime overlays.
  Target mode keeps the base tree's address-cell count; changing it on a live
  node is rejected by OF overlay. The target child has no reg property.
  ESP32-P4 rev1 GPSPI2 supports single-bit PIO master mode and native CS0 in
  this binding. Flash/PSRAM peripherals are not described by this binding.

allOf:
  - $ref: spi-controller.yaml#
  - if:
      properties:
        compatible:
          const: espressif,esp32p4-rev1-gpspi
    then:
      properties:
        dmas: false
        dma-names: false
        spi-slave: false
        cs-gpios: false
        num-cs:
          const: 1
        espressif,gpio-cs-drive-strength: false
        espressif,max-data-lines: false
      required:
        - resets
        - pinctrl-0
        - pinctrl-names

properties:
  compatible:
    enum:
      - espressif,esp32s31-gpspi
      - espressif,esp32p4-rev1-gpspi

  reg:
    maxItems: 1

  interrupts:
    maxItems: 1

  clocks:
    maxItems: 1

  resets:
    maxItems: 1

  dmas:
    minItems: 2
    maxItems: 2

  dma-names:
    items:
      - const: tx
      - const: rx

  espressif,gpio-cs-drive-strength:
    $ref: /schemas/types.yaml#/definitions/uint32
    description: GPIO chip-select pad drive strength in mA.
    enum: [5, 10, 20, 40]

  espressif,max-data-lines:
    $ref: /schemas/types.yaml#/definitions/uint32
    description: Maximum controller data bus width.
    enum: [4, 8]

required:
  - compatible
  - reg
  - interrupts
  - clocks

unevaluatedProperties: false
...
```
