## Documentation/devicetree/bindings/net/can/espressif,esp32-twai.yaml
```yaml
# SPDX-License-Identifier: (GPL-2.0-only OR BSD-2-Clause)
%YAML 1.2
---
$id: http://devicetree.org/schemas/net/can/espressif,esp32-twai.yaml#
$schema: http://devicetree.org/meta-schemas/core.yaml#

title: Espressif ESP32-P4 Classic CAN controller

maintainers:
  - GrieferPig <grieferpig@users.noreply.github.com>

allOf:
  - $ref: can-controller.yaml#

properties:
  compatible:
    const: espressif,esp32p4-twai

  reg:
    maxItems: 1

  interrupts:
    maxItems: 1

  clocks:
    maxItems: 1

  resets:
    maxItems: 1

required:
  - compatible
  - reg
  - interrupts
  - clocks
  - resets

unevaluatedProperties: false
```

## Documentation/devicetree/bindings/net/espressif,esp32-dwmac.yaml
```yaml
# SPDX-License-Identifier: (GPL-2.0-only OR BSD-2-Clause)
%YAML 1.2
---
$id: http://devicetree.org/schemas/net/espressif,esp32-dwmac.yaml#
$schema: http://devicetree.org/meta-schemas/core.yaml#

title: Espressif ESP32 Ethernet MACs

maintainers:
  - GrieferPig <noreply@example.com>

allOf:
  - $ref: ethernet-controller.yaml#
  - if:
      properties:
        compatible:
          const: espressif,esp32p4-dwmac
    then:
      properties:
        clocks:
          items:
            - description: EMAC bus clock
            - description: RMII PHY reference-derived clock
            - description: PTP timestamp clock
        clock-names:
          items:
            - const: stmmaceth
            - const: rmii
            - const: ptp_ref
        interrupts:
          items:
            - description: Ethernet MAC
            - description: Wake-on-LAN power management
            - description: Low-power idle
        interrupt-names:
          items:
            - const: macirq
            - const: eth_wake_irq
            - const: eth_lpi
        phy-mode:
          const: rmii
    else:
      properties:
        clocks:
          items:
            - description: EMAC bus clock
            - description: EMAC peripheral clock
            - description: PTP timestamp clock
            - description: RGMII transmit clock
        clock-names:
          items:
            - const: stmmaceth
            - const: pclk
            - const: ptp_ref
            - const: tx
        interrupts:
          maxItems: 1
        interrupt-names:
          const: macirq
        memory-region: false

properties:
  compatible:
    oneOf:
      - const: espressif,esp32p4-dwmac
      - items:
          - const: espressif,esp32s31-gmac
          - const: snps,dwmac

  reg:
    maxItems: 1

  memory-region:
    maxItems: 1
    description: Coherent HP L2 SRAM for the DMA descriptor rings and frame buffers.

  resets:
    maxItems: 1

  reset-names:
    const: stmmaceth

  power-domains:
    maxItems: 1

  snps,clk-csr:
    $ref: /schemas/types.yaml#/definitions/uint32
    description: GMII address register clock-range selector.

  snps,aal:
    type: boolean
    description: Align AHB bursts to address boundaries.

  snps,pbl:
    $ref: /schemas/types.yaml#/definitions/uint32
    description: Programmable DMA burst length in beats.

  snps,no-pbl-x8:
    type: boolean
    description: Disable the eightfold DMA burst multiplier.

  mdio:
    $ref: mdio.yaml#

required:
  - compatible
  - reg
  - interrupts
  - interrupt-names
  - clocks
  - clock-names
  - phy-mode

unevaluatedProperties: false
```

## Documentation/devicetree/bindings/net/espressif,esp32p4-dwmac.yaml
```yaml
# SPDX-License-Identifier: (GPL-2.0-only OR BSD-2-Clause)
%YAML 1.2
---
$id: http://devicetree.org/schemas/net/espressif,esp32p4-dwmac.yaml#
$schema: http://devicetree.org/meta-schemas/core.yaml#

title: Espressif ESP32-P4 Ethernet MAC with external RMII clock

maintainers:
  - GrieferPig <noreply@example.com>

allOf:
  - $ref: ethernet-controller.yaml#

properties:
  compatible:
    const: espressif,esp32p4-dwmac

  reg:
    maxItems: 1

  clocks:
    items:
      - description: EMAC bus clock
      - description: RMII PHY reference-derived clock
      - description: PTP timestamp clock

  clock-names:
    items:
      - const: stmmaceth
      - const: rmii
      - const: ptp_ref

  interrupts:
    items:
      - description: Ethernet MAC
      - description: Wake-on-LAN power management
      - description: Low-power idle

  interrupt-names:
    items:
      - const: macirq
      - const: eth_wake_irq
      - const: eth_lpi

  phy-mode:
    const: rmii

  snps,clk-csr:
    $ref: /schemas/types.yaml#/definitions/uint32
    description: GMII address register clock-range selector.

  snps,aal:
    type: boolean
    description: Align AHB bursts to address boundaries.

  snps,pbl:
    $ref: /schemas/types.yaml#/definitions/uint32
    description: Programmable DMA burst length in beats.

  snps,no-pbl-x8:
    type: boolean
    description: Disable the eightfold DMA burst multiplier.

  mdio:
    $ref: mdio.yaml#

required:
  - compatible
  - reg
  - interrupts
  - interrupt-names
  - clocks
  - clock-names
  - phy-mode

unevaluatedProperties: false
```

## Documentation/devicetree/bindings/phy/espressif,esp32-usb-phy.yaml
```yaml
# SPDX-License-Identifier: (GPL-2.0-only OR BSD-2-Clause)
%YAML 1.2
---
$id: http://devicetree.org/schemas/phy/espressif,esp32-usb-phy.yaml#
$schema: http://devicetree.org/meta-schemas/core.yaml#

title: Espressif ESP32 internal USB PHYs

maintainers:
  - GrieferPig <noreply@example.com>

description: |
  The P4 full-speed OTG controller can select either internal FS/LS PHY.
  PHY 0 normally belongs to native USB Serial/JTAG. Disable Serial/JTAG
  when the OTG connector needs to use that shared transceiver.

properties:
  compatible:
    enum:
      - espressif,esp32s31-usb-phy
      - espressif,esp32p4-rev1-usb-phy
      - espressif,esp32p4-rev1-usb-fs-phy

  '#phy-cells':
    const: 0

required:
  - compatible
  - reg
  - reg-names
  - '#phy-cells'

oneOf:
  - properties:
      compatible:
        const: espressif,esp32s31-usb-phy

      reg:
        minItems: 5
        maxItems: 5

      reg-names:
        items:
          - const: utmi
          - const: clkrst
          - const: otg-ctrl
          - const: usb-ctrl
          - const: phy-ctrl

      power-domains:
        maxItems: 1

    required:
      - power-domains
  - properties:
      compatible:
        const: espressif,esp32p4-rev1-usb-phy

      reg:
        minItems: 2
        maxItems: 3

      reg-names:
        minItems: 2
        maxItems: 3

      espressif,otg-clkrst:
        $ref: /schemas/types.yaml#/definitions/phandle
        description: Shared USB clock/reset register, LP_CLKRST_HP_USB_CLKRST_CTRL1.

      clocks:
        maxItems: 1
        description: USB high-speed peripheral bus clock

    required:
      - reg
      - reg-names
      - clocks

    allOf:
      - if:
          required:
            - espressif,otg-clkrst
        then:
          properties:
            reg:
              maxItems: 2
            reg-names:
              items:
                - const: utmi
                - const: phy-ctrl
        else:
          properties:
            reg:
              minItems: 3
            reg-names:
              items:
                - const: utmi
                - const: otg-ctrl
                - const: phy-ctrl
  - properties:
      compatible:
        const: espressif,esp32p4-rev1-usb-fs-phy

      reg:
        items:
          - description: USB_WRAP_OTG_CONF
          - description: LP_CLKRST_HP_USB_CLKRST_CTRL0
          - description: LP_SYSTEM_USB_CTRL

      reg-names:
        items:
          - const: wrap
          - const: phy-clock
          - const: phy-route

      clocks:
        maxItems: 1

      espressif,otg-clkrst:
        $ref: /schemas/types.yaml#/definitions/phandle
        description: Shared LP_CLKRST_HP_USB_CLKRST_CTRL1.

      espressif,phy-index:
        $ref: /schemas/types.yaml#/definitions/uint32
        enum: [0, 1]
        description: The internal transceiver wired to the OTG connector.

      espressif,shared-serial-jtag:
        $ref: /schemas/types.yaml#/definitions/phandle
        description: Native USB Serial/JTAG controller sharing PHY 0.

    required:
      - reg
      - reg-names
      - clocks
      - espressif,otg-clkrst
      - espressif,phy-index

unevaluatedProperties: false
```

## Documentation/devicetree/bindings/phy/espressif,esp32p4-rev1-usb-fs-phy.yaml
```yaml
# SPDX-License-Identifier: (GPL-2.0-only OR BSD-2-Clause)
%YAML 1.2
---
$id: http://devicetree.org/schemas/phy/espressif,esp32p4-rev1-usb-fs-phy.yaml#
$schema: http://devicetree.org/meta-schemas/core.yaml#

title: ESP32-P4 rev1 USB full-speed internal PHY

maintainers:
  - GrieferPig <noreply@example.com>

description: |
  The full-speed OTG controller can select either internal FS/LS PHY.
  PHY 0 normally belongs to the native USB Serial/JTAG controller.
  Boards that share connector pins with Serial/JTAG must disable that
  controller when using the connector for full-speed OTG.

properties:
  compatible:
    const: espressif,esp32p4-rev1-usb-fs-phy

  reg:
    items:
      - description: USB_WRAP_OTG_CONF
      - description: LP_CLKRST_HP_USB_CLKRST_CTRL0
      - description: LP_SYSTEM_USB_CTRL

  reg-names:
    items:
      - const: wrap
      - const: phy-clock
      - const: phy-route

  clocks:
    maxItems: 1

  espressif,otg-clkrst:
    $ref: /schemas/types.yaml#/definitions/phandle
    description: Shared LP_CLKRST_HP_USB_CLKRST_CTRL1.

  espressif,phy-index:
    $ref: /schemas/types.yaml#/definitions/uint32
    enum: [0, 1]
    description: The internal transceiver wired to the OTG connector.

  espressif,shared-serial-jtag:
    $ref: /schemas/types.yaml#/definitions/phandle
    description: Native USB Serial/JTAG controller sharing PHY 0.

  '#phy-cells':
    const: 0

required:
  - compatible
  - reg
  - reg-names
  - clocks
  - espressif,otg-clkrst
  - espressif,phy-index
  - '#phy-cells'

additionalProperties: false
```

## Documentation/devicetree/bindings/phy/espressif,esp32p4-rev1-usb-phy.yaml
```yaml
# SPDX-License-Identifier: (GPL-2.0-only OR BSD-2-Clause)
%YAML 1.2
---
$id: http://devicetree.org/schemas/phy/espressif,esp32p4-rev1-usb-phy.yaml#
$schema: http://devicetree.org/meta-schemas/core.yaml#

title: ESP32-P4 rev1 USB2 UTMI PHY

maintainers:
  - GrieferPig <noreply@example.com>

properties:
  compatible:
    const: espressif,esp32p4-rev1-usb-phy

  reg:
    minItems: 2
    maxItems: 3

  reg-names:
    minItems: 2
    maxItems: 3

  espressif,otg-clkrst:
    $ref: /schemas/types.yaml#/definitions/phandle
    description: Shared USB clock/reset register, LP_CLKRST_HP_USB_CLKRST_CTRL1.

  clocks:
    maxItems: 1
    description: USB high-speed peripheral bus clock

  '#phy-cells':
    const: 0

required:
  - compatible
  - reg
  - reg-names
  - clocks
  - '#phy-cells'

allOf:
  - if:
      required:
        - espressif,otg-clkrst
    then:
      properties:
        reg:
          maxItems: 2
        reg-names:
          items:
            - const: utmi
            - const: phy-ctrl
    else:
      properties:
        reg:
          minItems: 3
        reg-names:
          items:
            - const: utmi
            - const: otg-ctrl
            - const: phy-ctrl

additionalProperties: false
```
