## Documentation/devicetree/bindings/clock/espressif,esp32-peripheral-clock.yaml
```yaml
# SPDX-License-Identifier: (GPL-2.0-only OR BSD-2-Clause)
%YAML 1.2
---
$id: http://devicetree.org/schemas/clock/espressif,esp32-peripheral-clock.yaml#
$schema: http://devicetree.org/meta-schemas/core.yaml#

title: ESP32-P4 rev1 peripheral clock and reset subset

maintainers:
  - GrieferPig <noreply@example.com>

description: |
  The I2C1, GPSPI2, IOMUX, SDMMC, high-speed USB and Ethernet clocks on ESP32-P4 hw_ver1
  and the I2C1 and GPSPI2 reset controls. Clock and reset identifiers are in
  dt-bindings/clock/esp32p4-peripheral-clock.h. I2C1 and GPSPI2 use XTAL.
  I2S0 takes XTAL through its fractional MCLK divider. LEDC uses XTAL.
  SDMMC uses PLL_F160M and requires the additional low-power reset register.

properties:
  compatible:
    const: espressif,esp32p4-rev1-peripheral-clock

  reg:
    minItems: 1
    items:
      - description: High-performance clock and reset block
      - description: Low-power SDMMC and EMAC reset register
      - description: Low-power HP pad clock control register
      - description: High-performance system GMAC mode register
      - description: Low-power clock source selection register

  espressif,lpperi:
    $ref: /schemas/types.yaml#/definitions/phandle
    description: LP peripheral clock select, gate and reset registers.

  clocks:
    minItems: 1
    items:
      - description: Crystal reference
      - description: PLL_F160M reference for SDMMC
      - description: External 50 MHz RMII reference
      - description: PARLIO clock at the external RX pad

  '#clock-cells':
    const: 1

  '#reset-cells':
    const: 1

required:
  - compatible
  - reg
  - clocks
  - '#clock-cells'
  - '#reset-cells'

additionalProperties: false
```

## Documentation/devicetree/bindings/clock/espressif,esp32p4-rev1-peripheral-clock.yaml
```yaml
# SPDX-License-Identifier: (GPL-2.0-only OR BSD-2-Clause)
%YAML 1.2
---
$id: http://devicetree.org/schemas/clock/espressif,esp32p4-rev1-peripheral-clock.yaml#
$schema: http://devicetree.org/meta-schemas/core.yaml#

title: ESP32-P4 rev1 peripheral clock and reset subset

maintainers:
  - GrieferPig <noreply@example.com>

description: |
  The HP_SYS_CLKRST I2C1, GPSPI2 and IOMUX gates and the I2C1/GPSPI2 reset
  controls on ESP32-P4 hw_ver1. Clock/reset identifiers are in
  dt-bindings/clock/esp32p4-peripheral-clock.h. Boot-critical clocks are not
  exposed. I2C1 and GPSPI2 take XTAL as the clock source.

properties:
  compatible:
    const: espressif,esp32p4-rev1-peripheral-clock

  reg:
    maxItems: 1

  clocks:
    maxItems: 1
    description: The board's crystal reference clock.

  '#clock-cells':
    const: 1

  '#reset-cells':
    const: 1

required:
  - compatible
  - reg
  - clocks
  - '#clock-cells'
  - '#reset-cells'

additionalProperties: false
```

## Documentation/devicetree/bindings/counter/espressif,esp32-rtc-timer.yaml
```yaml
# SPDX-License-Identifier: (GPL-2.0-only OR BSD-2-Clause)
%YAML 1.2
---
$id: http://devicetree.org/schemas/counter/espressif,esp32-rtc-timer.yaml#
$schema: http://devicetree.org/meta-schemas/core.yaml#

title: Espressif ESP32 RTC timers

maintainers:
  - Espressif Linux Port Maintainers <linux-riscv@espressif.com>

description:
  The P4 RTC timer has a free-running 48-bit counter in the always-on domain.
  The capture registers retain the current and previous hardware snapshots.

properties:
  compatible:
    enum:
      - espressif,esp32s31-rtc-timer
      - espressif,esp32p4-rtc-timer

  reg:
    maxItems: 1

required:
  - compatible
  - reg

additionalProperties: false
```

## Documentation/devicetree/bindings/counter/espressif,esp32p4-rtc-timer.yaml
```yaml
# SPDX-License-Identifier: (GPL-2.0-only OR BSD-2-Clause)
%YAML 1.2
---
$id: http://devicetree.org/schemas/counter/espressif,esp32p4-rtc-timer.yaml#
$schema: http://devicetree.org/meta-schemas/core.yaml#

title: Espressif ESP32-P4 RTC timer

maintainers:
  - Espressif Linux Port Maintainers <linux-riscv@espressif.com>

description:
  The RTC timer has one free-running 48-bit counter in the always-on domain.
  The capture registers retain the current and previous hardware snapshots.

properties:
  compatible:
    const: espressif,esp32p4-rtc-timer

  reg:
    maxItems: 1

required:
  - compatible
  - reg

additionalProperties: false
```

## Documentation/devicetree/bindings/counter/espressif,esp32s31-gptimer.yaml
```yaml
# SPDX-License-Identifier: (GPL-2.0-only OR BSD-2-Clause)
%YAML 1.2
---
$id: http://devicetree.org/schemas/counter/espressif,esp32s31-gptimer.yaml#
$schema: http://devicetree.org/meta-schemas/core.yaml#

title: Espressif timer-group general-purpose timers

maintainers:
  - Espressif Linux Port Maintainers <linux-riscv@espressif.com>

properties:
  compatible:
    enum:
      - espressif,esp32p4-gptimer
      - espressif,esp32s31-gptimer

  reg:
    minItems: 1
    items:
      - description: Timer counters and alarm compare registers
      - description: Timer-group interrupt status, enable and clear registers

  reg-names:
    items:
      - const: counters
      - const: interrupts

  interrupts:
    items:
      - description: Timer 0 alarm interrupt
      - description: Timer 1 alarm interrupt

  interrupt-names:
    items:
      - const: timer0
      - const: timer1

  clocks:
    maxItems: 1

  espressif,reserved-timer-mask:
    $ref: /schemas/types.yaml#/definitions/uint32
    maximum: 3
    description:
      Bit mask of timer channels reserved by firmware and therefore omitted
      from the Linux Counter device. Bit 0 selects timer 0 and bit 1 timer 1.

required:
  - compatible
  - reg
  - clocks

allOf:
  - if:
      properties:
        compatible:
          const: espressif,esp32s31-gptimer
    then:
      properties:
        reg:
          maxItems: 1
        reg-names: false
        interrupts: false
        interrupt-names: false
    else:
      dependencies:
        interrupts: [reg-names, interrupt-names]
        reg-names: [interrupts, interrupt-names]

additionalProperties: false
...
```

## Documentation/devicetree/bindings/crypto/espressif,esp32-crypto.yaml
```yaml
# SPDX-License-Identifier: (GPL-2.0-only OR BSD-2-Clause)
%YAML 1.2
---
$id: http://devicetree.org/schemas/crypto/espressif,esp32-crypto.yaml#
$schema: http://devicetree.org/meta-schemas/core.yaml#

title: Espressif ESP32 cryptographic accelerators

maintainers:
  - GrieferPig <grieferpig@users.noreply.github.com>

properties:
  compatible:
    enum:
      - espressif,esp32s31-crypto
      - espressif,esp32p4-aes-sha
      - espressif,esp32p4-crypto

required:
  - compatible
  - reg

oneOf:
  - properties:
      compatible:
        const: espressif,esp32s31-crypto

      reg:
        items:
          - description: AES, SHA, RSA and ECC accelerator registers
          - description: Clock and reset register

      reg-names:
        items:
          - const: crypto
          - const: clkrst

      dmas:
        maxItems: 1

      dma-names:
        const: sha

    required:
      - reg-names
      - dmas
      - dma-names
  - properties:
      compatible:
        const: espressif,esp32p4-aes-sha

      reg:
        maxItems: 1
        description: Combined range covering the AES and SHA register banks.

      clocks:
        maxItems: 1
        description: Clock enabling the AES and SHA register banks and engines.

    required:
      - reg
      - clocks
  - properties:
      compatible:
        const: espressif,esp32p4-crypto

      reg:
        items:
          - description: AES and SHA register banks
          - description: RSA/MPI register bank
          - description: ECC register bank
          - description: HP system ECC memory power control register

      reg-names:
        items:
          - const: aes-sha
          - const: rsa
          - const: ecc
          - const: ecc-power

      clocks:
        items:
          - description: AES and SHA clock
          - description: RSA/MPI clock
          - description: ECC clock

      clock-names:
        items:
          - const: aes-sha
          - const: rsa
          - const: ecc

    required:
      - reg
      - reg-names
      - clocks
      - clock-names

unevaluatedProperties: false
```

## Documentation/devicetree/bindings/crypto/espressif,esp32p4-aes-sha.yaml
```yaml
# SPDX-License-Identifier: (GPL-2.0-only OR BSD-2-Clause)
%YAML 1.2
---
$id: http://devicetree.org/schemas/crypto/espressif,esp32p4-aes-sha.yaml#
$schema: http://devicetree.org/meta-schemas/core.yaml#

title: Espressif ESP32-P4 AES and SHA accelerators

maintainers:
  - GrieferPig <grieferpig@users.noreply.github.com>

description:
  The AES and SHA accelerators occupy adjacent register banks in the P4
  cryptographic subsystem. They share clock and reset dependencies with
  other engines in the subsystem.

properties:
  compatible:
    const: espressif,esp32p4-aes-sha

  reg:
    maxItems: 1
    description: Combined range covering the AES and SHA register banks.

  clocks:
    maxItems: 1
    description: Clock enabling the AES and SHA register banks and engines.

required:
  - compatible
  - reg
  - clocks

additionalProperties: false
```

## Documentation/devicetree/bindings/crypto/espressif,esp32p4-crypto.yaml
```yaml
# SPDX-License-Identifier: (GPL-2.0-only OR BSD-2-Clause)
%YAML 1.2
---
$id: http://devicetree.org/schemas/crypto/espressif,esp32p4-crypto.yaml#
$schema: http://devicetree.org/meta-schemas/core.yaml#

title: Espressif ESP32-P4 AES, SHA, RSA and ECC accelerators

maintainers:
  - GrieferPig <grieferpig@users.noreply.github.com>

properties:
  compatible:
    const: espressif,esp32p4-crypto

  reg:
    items:
      - description: AES and SHA register banks
      - description: RSA/MPI register bank
      - description: ECC register bank
      - description: HP system ECC memory power control register

  reg-names:
    items:
      - const: aes-sha
      - const: rsa
      - const: ecc
      - const: ecc-power

  clocks:
    items:
      - description: AES and SHA clock
      - description: RSA/MPI clock
      - description: ECC clock

  clock-names:
    items:
      - const: aes-sha
      - const: rsa
      - const: ecc

required:
  - compatible
  - reg
  - reg-names
  - clocks
  - clock-names

additionalProperties: false
```

## Documentation/devicetree/bindings/display/espressif,esp32-i80-ili9341.yaml
```yaml
# SPDX-License-Identifier: (GPL-2.0-only OR BSD-2-Clause)
%YAML 1.2
---
$id: http://devicetree.org/schemas/display/espressif,esp32-i80-ili9341.yaml#
$schema: http://devicetree.org/meta-schemas/core.yaml#

title: ESP32-S31 LCD_CAM with an Intel 8080 ILI9341 panel

maintainers:
  - Espressif Linux Port Maintainers <linux-riscv@espressif.com>

description:
  An ILI9341 panel connected to the LCD_CAM 8-bit Intel 8080 bus. The LCD
  transmitter fetches pixels from memory through the LCD request of AXI GDMA.
  The panel read strobe is kept deasserted. Shields with shared four-wire
  resistive touch electrodes can sample them between LCD transfers.

properties:
  compatible:
    const: espressif,esp32s31-i80-ili9341

  reg:
    items:
      - description: LCD_CAM registers
      - description: LCD_CAM-specific HP_SYS_CLKRST registers

  reg-names:
    items:
      - const: lcdcam
      - const: clkrst

  interrupts:
    maxItems: 1
    description: LCD_CAM interrupt including LCD transfer completion.

  clocks:
    items:
      - description: LCD functional clock from PLL_F160M
      - description: LCD_CAM shared core clock from PLL_F120M

  clock-names:
    items:
      - const: lcd
      - const: core

  clock-frequency:
    description: Maximum frequency of the panel write strobe in Hz.
    maximum: 15000000

  dmas:
    maxItems: 1

  dma-names:
    const: tx

  reset-gpios:
    maxItems: 1

  rd-gpios:
    maxItems: 1

  pinctrl-0: true
  pinctrl-1: true
  pinctrl-2: true
  pinctrl-3: true
  pinctrl-4: true
  pinctrl-5: true

  pinctrl-names:
    oneOf:
      - items:
          - const: default
      - items:
          - const: default
          - const: touch-detect
          - const: touch-x
          - const: touch-x-reverse
          - const: touch-y
          - const: touch-y-reverse

  io-channels:
    items:
      - description: ADC1 input on GPIO42.
      - description: ADC1 input on GPIO43.

  io-channel-names:
    items:
      - const: gpio42
      - const: gpio43

dependencies:
  io-channels: [io-channel-names, pinctrl-1, pinctrl-2, pinctrl-3, pinctrl-4, pinctrl-5]
  io-channel-names: [io-channels]

required:
  - compatible
  - reg
  - reg-names
  - clocks
  - clock-names
  - clock-frequency
  - dmas
  - dma-names
  - reset-gpios
  - rd-gpios
  - pinctrl-0
  - pinctrl-names

additionalProperties: false
```

## Documentation/devicetree/bindings/dma/espressif,esp32-axi-gdma.yaml
```yaml
# SPDX-License-Identifier: (GPL-2.0-only OR BSD-2-Clause)
%YAML 1.2
---
$id: http://devicetree.org/schemas/dma/espressif,esp32-axi-gdma.yaml#
$schema: http://devicetree.org/meta-schemas/core.yaml#

title: Espressif ESP32-S31 and ESP32-P4 AXI GDMA controller

maintainers:
  - Espressif Linux Port Maintainers <linux-riscv@espressif.com>

description: |
  AXI GDMA engine with three RX and three TX channels. The third register
  window on the ESP32-S31 is the 12 KiB descriptor pool in loader-reserved
  HP SRAM. The two DMA specifier cells select a channel pair and peripheral
  trigger respectively.

properties:
  compatible:
    enum:
      - espressif,esp32s31-axi-gdma
      - espressif,esp32p4-axi-gdma

  reg:
    minItems: 1
    maxItems: 3

  reg-names:
    items:
      - const: dma
      - const: clkrst
      - const: descriptors

  clocks:
    maxItems: 1

  resets:
    maxItems: 1

  interrupts:
    minItems: 6
    maxItems: 6

  interrupt-names:
    items:
      - const: rx0
      - const: rx1
      - const: rx2
      - const: tx0
      - const: tx1
      - const: tx2

  '#dma-cells':
    const: 2

  dma-channels:
    const: 3

required:
  - compatible
  - reg
  - interrupts
  - interrupt-names
  - '#dma-cells'

allOf:
  - if:
      properties:
        compatible:
          const: espressif,esp32p4-axi-gdma
    then:
      properties:
        reg:
          maxItems: 1
        reg-names: false
      required:
        - clocks
        - resets
    else:
      properties:
        reg:
          minItems: 3

additionalProperties: false

examples:
  - |
    #include <dt-bindings/interrupt-controller/irq.h>
    dma-controller@20348000 {
        compatible = "espressif,esp32s31-axi-gdma";
        reg = <0x20348000 0x1000>, <0x20587078 0x4>,
              <0x2f072380 0x3000>;
        reg-names = "dma", "clkrst", "descriptors";
        interrupts = <48 IRQ_TYPE_LEVEL_HIGH>,
                     <49 IRQ_TYPE_LEVEL_HIGH>,
                     <50 IRQ_TYPE_LEVEL_HIGH>,
                     <51 IRQ_TYPE_LEVEL_HIGH>,
                     <52 IRQ_TYPE_LEVEL_HIGH>,
                     <53 IRQ_TYPE_LEVEL_HIGH>;
        interrupt-names = "rx0", "rx1", "rx2",
                          "tx0", "tx1", "tx2";
        #dma-cells = <2>;
        dma-channels = <3>;
    };
...
```
