## Documentation/devicetree/bindings/dma/espressif,esp32p4-ahb-gdma.yaml
```yaml
# SPDX-License-Identifier: (GPL-2.0-only OR BSD-2-Clause)
%YAML 1.2
---
$id: http://devicetree.org/schemas/dma/espressif,esp32p4-ahb-gdma.yaml#
$schema: http://devicetree.org/meta-schemas/core.yaml#

title: Espressif ESP32-P4 AHB GDMA controller

maintainers:
  - Espressif Linux Port Maintainers <linux-riscv@espressif.com>

description: |
  Three pairs of receive and transmit channels. DMA descriptors are
  allocated in coherent low SRAM while payload buffers may use PSRAM.

properties:
  compatible:
    const: espressif,esp32p4-ahb-gdma

  reg:
    maxItems: 1

  interrupts:
    items:
      - description: RX channel 0
      - description: RX channel 1
      - description: RX channel 2
      - description: TX channel 0
      - description: TX channel 1
      - description: TX channel 2

  clocks:
    maxItems: 1

  resets:
    maxItems: 1

  '#dma-cells':
    const: 2
    description: Channel pair index followed by the peripheral request number.

required:
  - compatible
  - reg
  - interrupts
  - clocks
  - resets
  - '#dma-cells'

additionalProperties: false
```

## Documentation/devicetree/bindings/dma/espressif,esp32p4-dma2d.yaml
```yaml
# SPDX-License-Identifier: (GPL-2.0-only OR BSD-2-Clause)
%YAML 1.2
---
$id: http://devicetree.org/schemas/dma/espressif,esp32p4-dma2d.yaml#
$schema: http://devicetree.org/meta-schemas/core.yaml#

title: Espressif 2D DMA memory-to-memory controller

maintainers:
  - Espressif Linux Port Maintainers <linux-riscv@espressif.com>

description: |
  The two memory-to-memory channel pairs support linear and strided copies.
  A memory-to-memory channel does not require a peripheral DMA specifier.

properties:
  compatible:
    enum:
      - espressif,esp32p4-dma2d
      - espressif,esp32s31-dma2d

  reg:
    maxItems: 1

  clocks:
    maxItems: 1

  resets:
    maxItems: 1

  interrupts:
    minItems: 4
    maxItems: 4

  interrupt-names:
    items:
      - const: tx0
      - const: rx0
      - const: tx1
      - const: rx1

required:
  - compatible
  - reg
  - clocks
  - resets
  - interrupts
  - interrupt-names

additionalProperties: false
```

## Documentation/devicetree/bindings/firmware/espressif,esp32p4-idf-services.yaml
```yaml
# SPDX-License-Identifier: (GPL-2.0-only OR BSD-2-Clause)
%YAML 1.2
---
$id: http://devicetree.org/schemas/firmware/espressif,esp32p4-idf-services.yaml#
$schema: http://devicetree.org/meta-schemas/core.yaml#

title: Espressif ESP32-P4 retained cold-init firmware services

maintainers:
  - Espressif ESP32-P4 Linux port

description: |
  On the ESP32-P4 the cold-init firmware keeps running from retained SRAM
  after the kernel has taken over.  The firmware owns a few engines that the
  kernel cannot initialize a second time, and exposes them as callbacks in a
  fixed SRAM window.

  This node only says which services the resident firmware provides.  The
  callback addresses are firmware-internal and therefore described here
  instead of being hardcoded in the kernel; consumers reference the service
  child by its ABI id.

properties:
  compatible:
    const: espressif,esp32p4-idf-services

  "#address-cells":
    const: 1

  "#size-cells":
    const: 0

  abi-version:
    $ref: /schemas/types.yaml#/definitions/uint32
    description: Retained firmware call ABI version.

patternProperties:
  "^service@[0-2]$":
    type: object
    additionalProperties: false
    description: |
      One firmware callback.  The unit address is the ABI service id defined
      by the retained firmware handoff contract.

    properties:
      reg:
        maxItems: 1
        description:
          ABI service id: 0 executable cache sync, 1 display writeback,
          2 camera invalidate.

      espressif,entry:
        $ref: /schemas/types.yaml#/definitions/uint32
        description: |
          Physical address of the callback inside the retained SRAM window.

    required:
      - reg
      - espressif,entry

required:
  - compatible
  - "#address-cells"
  - "#size-cells"

additionalProperties: false

examples:
  - |
    firmware-services {
        compatible = "espressif,esp32p4-idf-services";
        #address-cells = <1>;
        #size-cells = <0>;

        service@0 {
            reg = <0>;
            espressif,entry = <0x4ff00000>;
        };
    };
...
```

## Documentation/devicetree/bindings/hwmon/espressif,esp32s31-tsens.yaml
```yaml
# SPDX-License-Identifier: (GPL-2.0-only OR BSD-2-Clause)
%YAML 1.2
---
$id: http://devicetree.org/schemas/hwmon/espressif,esp32s31-tsens.yaml#
$schema: http://devicetree.org/meta-schemas/core.yaml#

title: Espressif ESP32-S31 and ESP32-P4 on-chip temperature sensor

maintainers:
  - Espressif Linux Port Maintainers <linux-riscv@espressif.com>

properties:
  compatible:
    enum:
      - espressif,esp32s31-tsens
      - espressif,esp32p4-tsens

  reg:
    minItems: 1
    maxItems: 4

  reg-names:
    minItems: 1
    maxItems: 4

  espressif,lpperi:
    $ref: /schemas/types.yaml#/definitions/phandle
    description: ESP32-P4 LP peripheral clock and reset registers.

  interrupts:
    maxItems: 1

  espressif,analog-i2c:
    $ref: /schemas/types.yaml#/definitions/phandle
    description: Shared ESP32-P4 internal analog sensor register bus.

  analog-supply:
    description: Shared analog register-I2C power switch.

required:
  - compatible
  - reg
  - reg-names
  - interrupts
allOf:
  - if:
      properties:
        compatible:
          const: espressif,esp32s31-tsens
    then:
      properties:
        reg:
          minItems: 2
          maxItems: 2
        reg-names:
          items:
            - const: tsens
            - const: clkrst
      required:
        - analog-supply
    else:
      if:
        required:
          - espressif,lpperi
      then:
        if:
          required:
            - espressif,analog-i2c
        then:
          properties:
            reg:
              maxItems: 1
            reg-names:
              items:
                - const: tsens
        else:
          properties:
            reg:
              minItems: 2
              maxItems: 2
            reg-names:
              items:
                - const: tsens
                - const: analog-i2c
        required:
          - analog-supply
      else:
        properties:
          reg:
            minItems: 4
          reg-names:
            items:
              - const: tsens
              - const: clkrst
              - const: analog-i2c
              - const: analog-power
          analog-supply: false

additionalProperties: false

examples:
  - |
    temperature-sensor@20818000 {
        compatible = "espressif,esp32s31-tsens";
        reg = <0x20818000 0x2c>, <0x20710030 0x4>;
        reg-names = "tsens", "clkrst";
        interrupts = <150 4>;
    };
...
```

## Documentation/devicetree/bindings/i2c/espressif,esp32s31-i2c.yaml
```yaml
# SPDX-License-Identifier: (GPL-2.0-only OR BSD-2-Clause)
%YAML 1.2
---
$id: http://devicetree.org/schemas/i2c/espressif,esp32s31-i2c.yaml#
$schema: http://devicetree.org/meta-schemas/core.yaml#

title: Espressif ESP32-S31 and ESP32-P4 I2C controllers

description: |
  ESP32-S31 and native ESP32-P4 rev1 HP I2C1 use Linux clock, reset and
  pinctrl resources. The retained P4 compatible describes HP I2C1 initialized
  by the revision-103 IDF
  display loader at 100 kHz on GPIO7 (SDA) and GPIO8 (SCL). Its clock and
  pad setup must remain enabled across handoff. Cold initialization is
  not supported by the retained compatible.

maintainers:
  - GrieferPig <noreply@example.com>

allOf:
  - $ref: /schemas/i2c/i2c-controller.yaml#
  - if:
      properties:
        compatible:
          const: espressif,esp32p4-idf-i2c
    then:
      properties:
        clocks: false
        resets: false
        clock-frequency:
          const: 100000
    else:
      required:
        - clocks
  - if:
      properties:
        compatible:
          const: espressif,esp32p4-rev1-i2c
    then:
      required:
        - resets
        - pinctrl-0
        - pinctrl-names

properties:
  compatible:
    enum:
      - espressif,esp32s31-i2c
      - espressif,esp32p4-idf-i2c
      - espressif,esp32p4-rev1-i2c

  reg:
    maxItems: 1

  interrupts:
    maxItems: 1

  clocks:
    maxItems: 1

  resets:
    maxItems: 1

  espressif,param-name:
    $ref: /schemas/types.yaml#/definitions/string
    description: Property exposed by the overlay tool as a configurable scalar.
    const: clock-frequency

  espressif,param-values:
    $ref: /schemas/types.yaml#/definitions/uint32-array
    description: Allowed clock frequencies for the overlay tool.
    minItems: 1
    maxItems: 3

  clock-frequency:
    default: 100000
    minimum: 50000
    maximum: 1000000

required:
  - compatible
  - reg
  - interrupts
  - '#address-cells'
  - '#size-cells'

unevaluatedProperties: false

examples:
  - |
    i2c@20385000 {
        compatible = "espressif,esp32s31-i2c";
        reg = <0x20385000 0x200>;
        interrupts = <23 4>;
        clocks = <&clkc 25>;
        clock-frequency = <100000>;
        #address-cells = <1>;
        #size-cells = <0>;
    };
```

## Documentation/devicetree/bindings/i3c/espressif,esp32-i3c.yaml
```yaml
# SPDX-License-Identifier: (GPL-2.0-only OR BSD-2-Clause)
%YAML 1.2
---
$id: http://devicetree.org/schemas/i3c/espressif,esp32-i3c.yaml#
$schema: http://devicetree.org/meta-schemas/core.yaml#

title: Espressif ESP32-P4 I3C master controller

maintainers:
  - GrieferPig <noreply@example.com>

allOf:
  - $ref: i3c.yaml#

properties:
  compatible:
    const: espressif,esp32p4-i3c

  reg:
    maxItems: 1

  interrupts:
    maxItems: 1

  clocks:
    maxItems: 1

  resets:
    maxItems: 1

required:
  - compatible
  - reg
  - interrupts
  - clocks
  - resets

unevaluatedProperties: false
```

## Documentation/devicetree/bindings/iio/adc/espressif,esp32-adc.yaml
```yaml
# SPDX-License-Identifier: (GPL-2.0-only OR BSD-2-Clause)
%YAML 1.2
---
$id: http://devicetree.org/schemas/iio/adc/espressif,esp32-adc.yaml#
$schema: http://devicetree.org/meta-schemas/core.yaml#

title: Espressif ESP32 SAR ADC controllers

maintainers:
  - Espressif Linux Port Maintainers <linux-riscv@espressif.com>

description: |
  The P4 LP controller handles one-shot reads. When the HP controller
  and AHB GDMA are described, the same ADC1 inputs support buffered
  scans. Both controllers share the analog conversion hardware.

properties:
  compatible:
    enum:
      - espressif,esp32s31-adc
      - espressif,esp32p4-lp-adc

  analog-supply:
    description: Shared power switch for the analog register-I2C domain.

required:
  - compatible
  - reg
  - analog-supply

oneOf:
  - properties:
      compatible:
        const: espressif,esp32s31-adc

      reg:
        items:
          - description: SAR ADC register block
          - description: LP ADC clock and reset register

      reg-names:
        items:
          - const: adc
          - const: clkrst

      interrupts:
        maxItems: 1

      '#io-channel-cells':
        const: 1

      espressif,filter-channels:
        $ref: /schemas/types.yaml#/definitions/uint32-array
        minItems: 1
        maxItems: 2
        items:
          maximum: 15
        description: ADC channels assigned to the two hardware IIR filters.

      espressif,filter-factors:
        $ref: /schemas/types.yaml#/definitions/uint32-array
        minItems: 1
        maxItems: 2
        items:
          enum: [2, 4, 8, 16, 32, 64]
        description: IIR smoothing factors paired with filter-channels.

    required:
      - reg
      - reg-names
      - interrupts
      - '#io-channel-cells'

    dependencies:
      espressif,filter-channels: [espressif,filter-factors]
      espressif,filter-factors: [espressif,filter-channels]
  - properties:
      compatible:
        const: espressif,esp32p4-lp-adc

      reg:
        minItems: 1
        items:
          - description: LP controller registers
          - description: HP controller registers

      reg-names:
        items:
          - const: lp
          - const: hp

      clocks:
        maxItems: 1

      resets:
        maxItems: 1

      dmas:
        description: AHB GDMA channel and HP ADC request selector.
        maxItems: 1

      dma-names:
        const: rx

      espressif,lpperi:
        $ref: /schemas/types.yaml#/definitions/phandle
        description: The LP peripheral clock and reset register block.

      espressif,adc-inputs:
        $ref: /schemas/types.yaml#/definitions/uint32-array
        description: |
          ADC inputs wired for analog measurements on the board. Indices 0 through
          7 select ADC1 inputs 0 through 7. Indices 8 through 13 select ADC2 inputs
          0 through 5.
        minItems: 1
        maxItems: 14
        uniqueItems: true
        items:
          maximum: 13

      espressif,analog-i2c:
        $ref: /schemas/types.yaml#/definitions/phandle
        description: Shared internal analog register bus for factory offset setup.

      nvmem-cells:
        items:
          - description: eFuse calibration layout version
          - description: ADC1 factory offset for 0 dB
          - description: ADC2 factory offset for 0 dB

      nvmem-cell-names:
        items:
          - const: otp-version
          - const: adc1-offset
          - const: adc2-offset

    required:
      - reg
      - espressif,lpperi
      - espressif,adc-inputs

    allOf:
      - if:
          properties:
            reg:
              minItems: 2
        then:
          required:
            - reg-names
            - clocks
            - resets
            - dmas
            - dma-names
        else:
          properties:
            reg-names: false
            clocks: false
            resets: false
            dmas: false
            dma-names: false

    dependencies:
      espressif,analog-i2c:
        - nvmem-cells
        - nvmem-cell-names

unevaluatedProperties: false

examples:
  - |
    adc@20815000 {
        compatible = "espressif,esp32s31-adc";
        reg = <0x20815000 0x400>, <0x20710020 0x4>;
        reg-names = "adc", "clkrst";
        interrupts = <144 4>;
        analog-supply = <&adc_supply>;
        #io-channel-cells = <1>;
    };
```
