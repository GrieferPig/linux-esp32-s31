## Documentation/devicetree/bindings/iio/adc/espressif,esp32p4-lp-adc.yaml
```yaml
# SPDX-License-Identifier: (GPL-2.0-only OR BSD-2-Clause)
%YAML 1.2
---
$id: http://devicetree.org/schemas/iio/adc/espressif,esp32p4-lp-adc.yaml#
$schema: http://devicetree.org/meta-schemas/core.yaml#

title: Espressif ESP32-P4 SAR ADC controllers

description: |
  The LP controller handles one-shot reads. When the HP controller and its
  AHB GDMA channel are described, the same ADC1 inputs support buffered
  scans. Both controllers share the analog conversion hardware.

maintainers:
  - Espressif Linux Port Maintainers <linux-riscv@espressif.com>

properties:
  compatible:
    const: espressif,esp32p4-lp-adc

  reg:
    minItems: 1
    items:
      - description: LP controller registers
      - description: HP controller registers

  reg-names:
    items:
      - const: lp
      - const: hp

  clocks:
    maxItems: 1

  resets:
    maxItems: 1

  dmas:
    description: AHB GDMA channel and HP ADC request selector.
    maxItems: 1

  dma-names:
    const: rx

  espressif,lpperi:
    $ref: /schemas/types.yaml#/definitions/phandle
    description: The LP peripheral clock and reset register block.

  espressif,adc-inputs:
    $ref: /schemas/types.yaml#/definitions/uint32-array
    description: |
      ADC inputs wired for analog measurements on the board. Indices 0 through
      7 select ADC1 inputs 0 through 7. Indices 8 through 13 select ADC2 inputs
      0 through 5.
    minItems: 1
    maxItems: 14
    uniqueItems: true
    items:
      maximum: 13

  espressif,analog-i2c:
    $ref: /schemas/types.yaml#/definitions/phandle
    description: Shared internal analog register bus for factory offset setup.

  nvmem-cells:
    items:
      - description: eFuse calibration layout version
      - description: ADC1 factory offset for 0 dB
      - description: ADC2 factory offset for 0 dB

  nvmem-cell-names:
    items:
      - const: otp-version
      - const: adc1-offset
      - const: adc2-offset

  analog-supply:
    description: Shared power switch for the analog register-I2C domain.

required:
  - compatible
  - reg
  - espressif,lpperi
  - espressif,adc-inputs
  - analog-supply

allOf:
  - if:
      properties:
        reg:
          minItems: 2
    then:
      required:
        - reg-names
        - clocks
        - resets
        - dmas
        - dma-names
    else:
      properties:
        reg-names: false
        clocks: false
        resets: false
        dmas: false
        dma-names: false

dependencies:
  espressif,analog-i2c:
    - nvmem-cells
    - nvmem-cell-names

additionalProperties: false
```

## Documentation/devicetree/bindings/media/espressif,esp32-rmt.yaml
```yaml
# SPDX-License-Identifier: (GPL-2.0-only OR BSD-2-Clause)
%YAML 1.2
---
$id: http://devicetree.org/schemas/media/espressif,esp32-rmt.yaml#
$schema: http://devicetree.org/meta-schemas/core.yaml#

title: Espressif ESP32-P4 Remote Control Peripheral

maintainers:
  - Espressif Linux Port Maintainers <linux-riscv@espressif.com>

description: |
  The driver uses transmit channel 0 and receive channel 4, with four
  RAM blocks assigned to each. Configure the pin controller to route
  channel 0 of the RMT output and input, respectively.

properties:
  compatible:
    const: espressif,esp32p4-rmt

  reg:
    maxItems: 1

  interrupts:
    maxItems: 1

  clocks:
    maxItems: 1

  resets:
    maxItems: 1

  espressif,rx-active-low:
    type: boolean
    description: The external receiver pulls the input low during a pulse.

required:
  - compatible
  - reg
  - interrupts
  - clocks
  - resets

additionalProperties: false
```

## Documentation/devicetree/bindings/media/espressif,esp32p4-jpeg.yaml
```yaml
# SPDX-License-Identifier: (GPL-2.0-only OR BSD-2-Clause)
%YAML 1.2
---
$id: http://devicetree.org/schemas/media/espressif,esp32p4-jpeg.yaml#
$schema: http://devicetree.org/meta-schemas/core.yaml#

title: Espressif ESP32-P4 JPEG codec

maintainers:
  - Espressif Linux Port Maintainers <linux-riscv@espressif.com>

description: |
  The codec consumes compressed input and writes decoded pixels via a paired
  2D-DMA transmit and receive channel.

properties:
  compatible:
    const: espressif,esp32p4-jpeg

  reg:
    maxItems: 1

  interrupts:
    maxItems: 1

  clocks:
    maxItems: 1

  resets:
    maxItems: 1

  dmas:
    maxItems: 1

  dma-names:
    const: codec

required:
  - compatible
  - reg
  - clocks
  - resets
  - dmas
  - dma-names

additionalProperties: false
```

## Documentation/devicetree/bindings/media/espressif,esp32p4-ppa.yaml
```yaml
# SPDX-License-Identifier: (GPL-2.0-only OR BSD-2-Clause)
%YAML 1.2
---
$id: http://devicetree.org/schemas/media/espressif,esp32p4-ppa.yaml#
$schema: http://devicetree.org/meta-schemas/core.yaml#

title: Espressif ESP32-P4 Pixel Processing Accelerator

maintainers:
  - Espressif Linux Port Maintainers <linux-riscv@espressif.com>

description: |
  The accelerator uses a paired 2D-DMA transmit and receive channel for
  its scale, rotate and mirror engine.

properties:
  compatible:
    const: espressif,esp32p4-ppa

  reg:
    maxItems: 1

  interrupts:
    maxItems: 1

  clocks:
    maxItems: 1

  resets:
    maxItems: 1

  dmas:
    maxItems: 1

  dma-names:
    const: srm

required:
  - compatible
  - reg
  - clocks
  - resets
  - dmas
  - dma-names

additionalProperties: false
```

## Documentation/devicetree/bindings/mfd/espressif,esp32-usb-clkrst.yaml
```yaml
# SPDX-License-Identifier: (GPL-2.0-only OR BSD-2-Clause)
%YAML 1.2
---
$id: http://devicetree.org/schemas/mfd/espressif,esp32-usb-clkrst.yaml#
$schema: http://devicetree.org/meta-schemas/core.yaml#

title: ESP32-P4 shared USB OTG clock and reset register

maintainers:
  - GrieferPig <noreply@example.com>

properties:
  compatible:
    items:
      - const: espressif,esp32p4-usb-clkrst
      - const: syscon

  reg:
    maxItems: 1
    description: LP_CLKRST_HP_USB_CLKRST_CTRL1.

required:
  - compatible
  - reg

additionalProperties: false
```

## Documentation/devicetree/bindings/mfd/espressif,esp32p4-analog-i2c.yaml
```yaml
# SPDX-License-Identifier: (GPL-2.0-only OR BSD-2-Clause)
%YAML 1.2
---
$id: http://devicetree.org/schemas/mfd/espressif,esp32p4-analog-i2c.yaml#
$schema: http://devicetree.org/meta-schemas/core.yaml#

title: Espressif ESP32-P4 internal analog sensor register bus

maintainers:
  - Espressif Linux Port Maintainers <linux-riscv@espressif.com>

description:
  The temperature sensor and SAR ADC access their calibration registers
  over this internal bus through the low-power analog I2C master.

properties:
  compatible:
    const: espressif,esp32p4-analog-i2c

  reg:
    maxItems: 1

  espressif,lpperi:
    $ref: /schemas/types.yaml#/definitions/phandle
    description: LP peripheral clock and reset register block.

  analog-supply:
    description: Shared power switch for the internal analog sensors.

required:
  - compatible
  - reg
  - espressif,lpperi
  - analog-supply

additionalProperties: false
```

## Documentation/devicetree/bindings/misc/espressif,esp32-parlio.yaml
```yaml
# SPDX-License-Identifier: (GPL-2.0-only OR BSD-2-Clause)
%YAML 1.2
---
$id: http://devicetree.org/schemas/misc/espressif,esp32-parlio.yaml#
$schema: http://devicetree.org/meta-schemas/core.yaml#

title: Espressif ESP32-P4 Parallel IO controller

maintainers:
  - GrieferPig <noreply@example.com>

description: |
  Parallel frame transmission and reception through AXI GDMA. The transmitter
  generates its own clock and the receiver samples on the external RX clock.
  Data lanes and clock pads are assigned with pinctrl.

properties:
  compatible:
    const: espressif,esp32p4-parlio

  reg:
    maxItems: 1

  interrupts:
    items:
      - description: Receiver FIFO interrupt
      - description: Transmitter FIFO and frame-end interrupt

  interrupt-names:
    items:
      - const: rx
      - const: tx

  clocks:
    items:
      - description: APB register and AXI peripheral interface clock gate
      - description: Receive sampling clock
      - description: Transmit bit clock
      - description: Crystal clock used to reset the receiver FIFO
      - description: Expected external receive clock

  clock-names:
    items:
      - const: bus
      - const: rx
      - const: tx
      - const: xtal
      - const: rx-pad

  resets:
    items:
      - description: Register interface
      - description: Receive clock domain
      - description: Transmit clock domain

  reset-names:
    items:
      - const: bus
      - const: rx
      - const: tx

  dmas:
    items:
      - description: Hardware RX from the peripheral to memory
      - description: Hardware TX from memory to the peripheral

  dma-names:
    items:
      - const: rx
      - const: tx

  espressif,data-width:
    $ref: /schemas/types.yaml#/definitions/uint32
    enum: [1, 2, 4, 8, 16]
    description: Maximum width wired to the pads in each direction.

  clock-frequency:
    description: Requested transmit clock frequency in Hz.
    minimum: 1
    maximum: 40000000

required:
  - compatible
  - reg
  - interrupts
  - interrupt-names
  - clocks
  - clock-names
  - resets
  - reset-names
  - dmas
  - dma-names
  - espressif,data-width
  - clock-frequency

additionalProperties: false
```

## Documentation/devicetree/bindings/mmc/espressif,esp32-dw-mshc.yaml
```yaml
# SPDX-License-Identifier: (GPL-2.0-only OR BSD-2-Clause)
%YAML 1.2
---
$id: http://devicetree.org/schemas/mmc/espressif,esp32-dw-mshc.yaml#
$schema: http://devicetree.org/meta-schemas/core.yaml#

title: Espressif ESP32-P4 SD/MMC Host Controller

maintainers:
  - GrieferPig <noreply@example.com>

allOf:
  - $ref: synopsys-dw-mshc-common.yaml#

properties:
  compatible:
    const: espressif,esp32p4-dw-mshc

  reg:
    maxItems: 1

  interrupts:
    maxItems: 1

  clocks:
    items:
      - description: Bus interface clock
      - description: Card interface clock

  clock-names:
    items:
      - const: biu
      - const: ciu

  espressif,slot-id:
    $ref: /schemas/types.yaml#/definitions/uint32
    enum: [0, 1]
    default: 0
    description: First physical slot exposed to Linux.

  espressif,num-slots:
    $ref: /schemas/types.yaml#/definitions/uint32
    enum: [1, 2]
    default: 1
    description: When set to two, both slots must have a slot node.

  '#address-cells':
    const: 1

  '#size-cells':
    const: 0

patternProperties:
  '^slot@[01]$':
    type: object
    allOf:
      - $ref: mmc-controller.yaml#
    properties:
      reg:
        maxItems: 1
    required:
      - reg
    unevaluatedProperties: false

required:
  - compatible
  - reg
  - interrupts
  - clocks
  - clock-names

unevaluatedProperties: false
```
