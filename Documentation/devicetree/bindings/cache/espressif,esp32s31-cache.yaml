## Documentation/devicetree/bindings/iio/adc/espressif,esp32s31-adc.yaml
```yaml
# SPDX-License-Identifier: (GPL-2.0-only OR BSD-2-Clause)
%YAML 1.2
---
$id: http://devicetree.org/schemas/iio/adc/espressif,esp32s31-adc.yaml#
$schema: http://devicetree.org/meta-schemas/core.yaml#

title: Espressif ESP32-S31 SAR ADC

maintainers:
  - Espressif Linux Port Maintainers <linux-riscv@espressif.com>

properties:
  compatible:
    const: espressif,esp32s31-adc

  reg:
    items:
      - description: SAR ADC register block
      - description: LP ADC clock and reset register

  reg-names:
    items:
      - const: adc
      - const: clkrst

  interrupts:
    maxItems: 1

  analog-supply:
    description: Shared analog register-I2C power switch.

  '#io-channel-cells':
    const: 1

  espressif,filter-channels:
    $ref: /schemas/types.yaml#/definitions/uint32-array
    minItems: 1
    maxItems: 2
    items:
      maximum: 15
    description: ADC channels assigned to the two hardware IIR filters.

  espressif,filter-factors:
    $ref: /schemas/types.yaml#/definitions/uint32-array
    minItems: 1
    maxItems: 2
    items:
      enum: [2, 4, 8, 16, 32, 64]
    description: IIR smoothing factors paired with filter-channels.

dependencies:
  espressif,filter-channels: [espressif,filter-factors]
  espressif,filter-factors: [espressif,filter-channels]

required:
  - compatible
  - reg
  - reg-names
  - interrupts
  - analog-supply
  - '#io-channel-cells'

additionalProperties: false

examples:
  - |
    adc@20815000 {
        compatible = "espressif,esp32s31-adc";
        reg = <0x20815000 0x400>, <0x20710020 0x4>;
        reg-names = "adc", "clkrst";
        interrupts = <144 4>;
        #io-channel-cells = <1>;
    };
...
```

## Documentation/devicetree/bindings/iio/dac/espressif,esp32s31-dac.yaml
```yaml
# SPDX-License-Identifier: (GPL-2.0-only OR BSD-2-Clause)
%YAML 1.2
---
$id: http://devicetree.org/schemas/iio/dac/espressif,esp32s31-dac.yaml#
$schema: http://devicetree.org/meta-schemas/core.yaml#

title: Espressif ESP32-S31 dual DAC

maintainers:
  - Espressif Linux Port Maintainers <linux-riscv@espressif.com>

properties:
  compatible:
    const: espressif,esp32s31-dac

  reg:
    items:
      - description: DAC register block
      - description: LP DAC clock and reset register

  reg-names:
    items:
      - const: dac
      - const: clkrst

  analog-supply: true

  '#io-channel-cells':
    const: 1

required:
  - compatible
  - reg
  - reg-names
  - analog-supply
  - '#io-channel-cells'

additionalProperties: false
...
```

## Documentation/devicetree/bindings/iio/proximity/espressif,esp32s31-comparator.yaml
```yaml
# SPDX-License-Identifier: (GPL-2.0-only OR BSD-2-Clause)
%YAML 1.2
---
$id: http://devicetree.org/schemas/iio/proximity/espressif,esp32s31-comparator.yaml#
$schema: http://devicetree.org/meta-schemas/core.yaml#

title: Espressif ESP32-S31 analog comparator

maintainers:
  - Espressif Linux Port Maintainers <linux-riscv@espressif.com>

description: |
  On-chip analog comparator exposed through IIO. The reference level
  programs the internal threshold; the driver defaults to 3 and rejects
  values above 7.

properties:
  compatible:
    const: espressif,esp32s31-comparator

  reg:
    items:
      - description: comparator registers
      - description: clock-reset registers

  reg-names:
    items:
      - const: comparator
      - const: clkrst

  interrupts:
    maxItems: 1

  espressif,reference-level:
    $ref: /schemas/types.yaml#/definitions/uint32
    default: 3
    maximum: 7
    description: Internal reference threshold level.

required:
  - compatible
  - reg

additionalProperties: false

examples:
  - |
    #include <dt-bindings/interrupt-controller/irq.h>
    comparator@2039a000 {
        compatible = "espressif,esp32s31-comparator";
        reg = <0x2039a000 0x400>, <0x205871b8 0x4>;
        reg-names = "comparator", "clkrst";
        interrupts = <135 IRQ_TYPE_LEVEL_HIGH>;
        espressif,reference-level = <3>;
    };
...
```

## Documentation/devicetree/bindings/media/espressif,esp32s31-media.yaml
```yaml
# SPDX-License-Identifier: (GPL-2.0-only OR BSD-2-Clause)
%YAML 1.2
---
$id: http://devicetree.org/schemas/media/espressif,esp32s31-media.yaml#
$schema: http://devicetree.org/meta-schemas/core.yaml#

title: Espressif ESP32-S31 JPEG and PPA memory engines

maintainers:
  - GrieferPig <grieferpig@163.com>

properties:
  compatible:
    enum:
      - espressif,esp32s31-jpeg
      - espressif,esp32s31-ppa
  reg:
    minItems: 2
    maxItems: 2
  clocks:
    maxItems: 1
  resets:
    maxItems: 1
  reg-names:
    items:
      - enum: [codec, processor]
      - const: memory-power
  espressif,dma2d:
    $ref: /schemas/types.yaml#/definitions/phandle
    description: Shared DMA2D provider, including descriptor SRAM and runtime PM.

required:
  - compatible
  - reg
  - clocks
  - resets
  - reg-names
  - espressif,dma2d
additionalProperties: false
...
```

## Documentation/devicetree/bindings/misc/espressif,esp32s31-bitscrambler.yaml
```yaml
# SPDX-License-Identifier: (GPL-2.0-only OR BSD-2-Clause)
%YAML 1.2
---
$id: http://devicetree.org/schemas/misc/espressif,esp32s31-bitscrambler.yaml#
$schema: http://devicetree.org/meta-schemas/core.yaml#

title: Espressif ESP32-S31 BitScrambler memory loopback

maintainers:
  - GrieferPig <grieferpig@163.com>

properties:
  compatible:
    enum:
      - espressif,esp32s31-bitscrambler
  reg:
    minItems: 3
    maxItems: 3
  clocks:
    maxItems: 1
  resets:
    maxItems: 1
  reg-names:
    items:
      - const: bitscrambler
      - const: route
      - const: memory-power
  dmas:
    minItems: 2
    maxItems: 2
  dma-names:
    items:
      - const: tx
      - const: rx

required:
  - compatible
  - reg
  - clocks
  - resets
  - reg-names
  - dmas
  - dma-names
additionalProperties: false
...
```

## Documentation/devicetree/bindings/misc/espressif,esp32s31-etm.yaml
```yaml
# SPDX-License-Identifier: (GPL-2.0-only OR BSD-2-Clause)
%YAML 1.2
---
$id: http://devicetree.org/schemas/misc/espressif,esp32s31-etm.yaml#
$schema: http://devicetree.org/meta-schemas/core.yaml#

title: Espressif ESP32-S31 event/task router

maintainers:
  - GrieferPig <grieferpig@163.com>

properties:
  compatible:
    enum:
      - espressif,esp32s31-etm
  reg:
    maxItems: 1
  clocks:
    maxItems: 1
  resets:
    maxItems: 1

required:
  - compatible
  - reg
  - clocks
  - resets

additionalProperties: false
...
```

## Documentation/devicetree/bindings/net/wireless/espressif,esp32s31-radio.yaml
```yaml
# SPDX-License-Identifier: (GPL-2.0-only OR BSD-2-Clause)
%YAML 1.2
---
$id: http://devicetree.org/schemas/net/wireless/espressif,esp32s31-radio.yaml#
$schema: http://devicetree.org/meta-schemas/core.yaml#

title: Espressif ESP32-S31 integrated Wi-Fi and Bluetooth radio

maintainers:
  - S31 Linux contributors <s31-linux@localhost>

description: |
  Shared ESP32-S31 radio runtime with independently selectable Wi-Fi and
  Bluetooth frontends. The parent and at least one child are enabled by a
  board overlay before the integrated radio module is loaded.

properties:
  compatible:
    const: espressif,esp32s31-radio

  status: true

  wifi:
    type: object
    additionalProperties: false
    properties:
      compatible:
        const: espressif,esp32s31-wifi
      status: true
    required:
      - compatible

  bluetooth:
    type: object
    additionalProperties: false
    properties:
      compatible:
        const: espressif,esp32s31-btdm
      status: true
    required:
      - compatible

required:
  - compatible
  - wifi
  - bluetooth

additionalProperties: false

examples:
  - |
    radio {
        compatible = "espressif,esp32s31-radio";
        status = "okay";

        wifi {
            compatible = "espressif,esp32s31-wifi";
            status = "okay";
        };

        bluetooth {
            compatible = "espressif,esp32s31-btdm";
            status = "disabled";
        };
    };
```

## Documentation/devicetree/bindings/nvmem/espressif,esp32s31-efuse.yaml
```yaml
# SPDX-License-Identifier: (GPL-2.0-only OR BSD-2-Clause)
%YAML 1.2
---
$id: http://devicetree.org/schemas/nvmem/espressif,esp32s31-efuse.yaml#
$schema: http://devicetree.org/meta-schemas/core.yaml#

title: Espressif ESP32-S31 eFuse read window

maintainers:
  - Espressif Linux Team <linux-esp32@espressif.com>

description: |
  The ESP32-S31 exposes read-only shadow registers for its eFuse blocks. This
  binding describes a block read window and fixed NVMEM cells within it. A
  mac-base cell is byte-swapped from the native eFuse register order by the
  provider before its phandle offset argument is applied.

allOf:
  - $ref: nvmem.yaml#

properties:
  compatible:
    const: espressif,esp32s31-efuse

  reg:
    maxItems: 1

required:
  - compatible
  - reg

unevaluatedProperties: false

examples:
  - |
    efuse@20715050 {
        compatible = "espressif,esp32s31-efuse";
        reg = <0x20715050 0x18>;
        read-only;

        nvmem-layout {
            compatible = "fixed-layout";
            #address-cells = <1>;
            #size-cells = <1>;

            factory_mac: mac-address@0 {
                compatible = "mac-base";
                reg = <0x0 0x6>;
                #nvmem-cell-cells = <1>;
            };
        };
    };
...
```

## Documentation/devicetree/bindings/pinctrl/espressif,esp32s31-pinctrl.yaml
```yaml
# SPDX-License-Identifier: (GPL-2.0-only OR BSD-2-Clause)
%YAML 1.2
---
$id: http://devicetree.org/schemas/pinctrl/espressif,esp32s31-pinctrl.yaml#
$schema: http://devicetree.org/meta-schemas/core.yaml#

title: Espressif ESP32-S31 pin controller and GPIO

maintainers:
  - Max Filippov <jcmvbkbc@gmail.com>

description: |
  ESP32-S31 has 60 bonded GPIO pads in the GPIO0 through GPIO61 number
  space. GPIO29 and GPIO41 are unbonded. Each pad has an IO_MUX function
  selector and can also connect to peripheral inputs and outputs through the
  GPIO matrix. The controller provides GPIO data, direction, pad electrical
  configuration and per-pin interrupts through four aggregate outputs. This
  binding uses aggregate output zero.

  Pin configuration nodes are children of a pinctrl state node. Their pinmux
  property consists of cells built with ESP32S31_IOMUX(),
  ESP32S31_IOMUX_IN(), ESP32S31_MATRIX_IN(), ESP32S31_MATRIX_OUT(), or
  ESP32S31_GPIO() from
  dt-bindings/pinctrl/esp32s31-pinmux.h. A group may mix those cell types and
  may contain both input and output routes for bidirectional peripherals.

properties:
  compatible:
    const: espressif,esp32s31-pinctrl

  reg:
    minItems: 3
    maxItems: 3

  reg-names:
    items:
      - const: gpio
      - const: iomux
      - const: cnnt-pad-ctrl

  gpio-controller: true

  '#gpio-cells':
    const: 2

  interrupt-controller: true

  '#interrupt-cells':
    const: 2

  interrupts:
    maxItems: 1

$defs:
  esp32s31-pin-group:
    type: object
    additionalProperties: false

    properties:
      pinmux:
        $ref: /schemas/types.yaml#/definitions/uint32-array
        minItems: 1
        description: Encoded IO_MUX and GPIO matrix operations.

      bias-disable: true
      bias-pull-up: true
      bias-pull-down: true
      input-enable: true
      input-disable: true
      input-schmitt-enable: true
      input-debounce:
        $ref: /schemas/types.yaml#/definitions/uint32
        description: A nonzero value enables the fixed hardware glitch filter.
      drive-open-drain: true
      drive-push-pull: true
      drive-strength:
        $ref: /schemas/types.yaml#/definitions/uint32
        enum: [5, 10, 20, 40]
        description: Approximate pad drive strength in mA.
      output-high: true
      output-low: true

    required:
      - pinmux

patternProperties:
  '-pins$':
    type: object
    additionalProperties: false
    patternProperties:
      '-pins$':
        $ref: '#/$defs/esp32s31-pin-group'

required:
  - compatible
  - reg
  - reg-names
  - gpio-controller
  - '#gpio-cells'
  - interrupt-controller
  - '#interrupt-cells'
  - interrupts

additionalProperties: false

examples:
  - |
    #include <dt-bindings/gpio/gpio.h>
    #include <dt-bindings/interrupt-controller/irq.h>
    #include <dt-bindings/pinctrl/esp32s31-pinmux.h>

    pinctrl@20583000 {
        compatible = "espressif,esp32s31-pinctrl";
        reg = <0x20583000 0x1000>, <0x20582000 0x1000>,
              <0x20588000 0x1000>;
        reg-names = "gpio", "iomux", "cnnt-pad-ctrl";
        gpio-controller;
        #gpio-cells = <2>;
        interrupt-controller;
        #interrupt-cells = <2>;
        interrupts = <18 61 IRQ_TYPE_LEVEL_HIGH>;

        uart-pins {
            tx-pins {
                pinmux = <ESP32S31_MATRIX_OUT(20, 10, 0)>;
                drive-strength = <20>;
            };
            rx-pins {
                pinmux = <ESP32S31_MATRIX_IN(21, 10, 0)>;
                bias-pull-up;
                input-enable;
            };
        };
    };
...
```

## Documentation/devicetree/bindings/power/espressif,esp32s31-pmu.yaml
```yaml
# SPDX-License-Identifier: (GPL-2.0-only OR BSD-2-Clause)
%YAML 1.2
---
$id: http://devicetree.org/schemas/power/espressif,esp32s31-pmu.yaml#
$schema: http://devicetree.org/meta-schemas/core.yaml#

title: Espressif ESP32-S31 power management unit

maintainers:
  - Espressif Linux Port Maintainers <linux-riscv@espressif.com>

description: |
  The PMU controls the TOP, HPALIVE, MODEMPWR, HPCPU, HPCNNT, MODEM and
  LP peripheral domains. Domains required by XIP, PSRAM, CPUs or the radio
  firmware are kept on. HPCNNT power-off is opt-in until every connectivity
  consumer is represented in the domain. Consumers without runtime PM remain
  active and safely keep the shared domain powered.

properties:
  compatible:
    const: espressif,esp32s31-pmu

  reg:
    maxItems: 1

  '#power-domain-cells':
    const: 1

  espressif,allow-hpcnnt-power-off:
    type: boolean
    description:
      Permit runtime power-off of HPCNNT. Boards must not set this until all
      enabled USB, SDMMC and Ethernet consumers have a power-domain reference.
      The domain powers off only after every attached consumer is suspended.

required:
  - compatible
  - reg
  - '#power-domain-cells'

additionalProperties: false

examples:
  - |
    power-controller@20704000 {
        compatible = "espressif,esp32s31-pmu";
        reg = <0x20704000 0x1000>;
        #power-domain-cells = <1>;
    };
...
```
