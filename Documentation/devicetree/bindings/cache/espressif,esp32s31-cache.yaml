## Documentation/devicetree/bindings/pwm/espressif,esp32s31-pwm.yaml
```yaml
# SPDX-License-Identifier: (GPL-2.0-only OR BSD-2-Clause)
%YAML 1.2
---
$id: http://devicetree.org/schemas/pwm/espressif,esp32s31-pwm.yaml#
$schema: http://devicetree.org/meta-schemas/core.yaml#

title: Espressif ESP32-S31 LEDC and motor-control PWM controllers

maintainers:
  - Espressif Linux Port Maintainers <linux-riscv@espressif.com>

properties:
  compatible:
    enum:
      - espressif,esp32s31-ledc
      - espressif,esp32s31-mcpwm

  reg:
    minItems: 1
    maxItems: 2

  clocks:
    maxItems: 1

  resets:
    maxItems: 1

  '#pwm-cells':
    const: 3

  espressif,fade-time-ms:
    description: LEDC blocking fade duration applied to duty changes.
    minimum: 1
    maximum: 60000

  espressif,gamma-correction:
    description: Use the LEDC gamma RAM for a quadratic brightness curve.
    type: boolean

  espressif,fault-mask:
    description: MCPWM GPIO fault inputs that trigger one-shot force-low.
    minimum: 0
    maximum: 7

  espressif,fault-active-high-mask:
    description: Polarity mask for the enabled MCPWM GPIO fault inputs.
    minimum: 0
    maximum: 7

  espressif,sync-inputs:
    description: MCPWM timer sync selectors, one for each of three timers.
    $ref: /schemas/types.yaml#/definitions/uint32-array
    minItems: 3
    maxItems: 3
    items:
      minimum: 0
      maximum: 6

  espressif,sync-phases:
    description: MCPWM timer phase values loaded by a sync edge.
    $ref: /schemas/types.yaml#/definitions/uint32-array
    minItems: 3
    maxItems: 3
    items:
      maximum: 65535

required:
  - compatible
  - reg
  - clocks
  - '#pwm-cells'

allOf:
  - $ref: pwm.yaml#
  - if:
      properties:
        compatible:
          const: espressif,esp32s31-ledc
    then:
      properties:
        reg:
          minItems: 2
          maxItems: 2
      allOf:
        - not:
            anyOf:
              - required: [espressif,fault-mask]
              - required: [espressif,fault-active-high-mask]
              - required: [espressif,sync-inputs]
              - required: [espressif,sync-phases]
    else:
      properties:
        reg:
          maxItems: 1
      allOf:
        - not:
            anyOf:
              - required: [espressif,fade-time-ms]
              - required: [espressif,gamma-correction]

unevaluatedProperties: false

examples:
  - |
    pwm@20392000 {
        compatible = "espressif,esp32s31-ledc";
        reg = <0x20392000 0x600>, <0x20586208 0x4>;
        clocks = <&clkc 1>;
        #pwm-cells = <3>;
        espressif,fade-time-ms = <250>;
        espressif,gamma-correction;
    };
...
```

## Documentation/devicetree/bindings/regulator/espressif,esp32s31-ana-i2c.yaml
```yaml
# SPDX-License-Identifier: (GPL-2.0-only OR BSD-2-Clause)
%YAML 1.2
---
$id: http://devicetree.org/schemas/regulator/espressif,esp32s31-ana-i2c.yaml#
$schema: http://devicetree.org/meta-schemas/core.yaml#

title: Espressif ESP32-S31 shared analog register-I2C power

maintainers:
  - Espressif Linux Port Maintainers <linux-riscv@espressif.com>

allOf:
  - $ref: regulator.yaml#

properties:
  compatible:
    const: espressif,esp32s31-ana-i2c

  reg:
    maxItems: 1

required:
  - compatible
  - reg

unevaluatedProperties: false

examples:
  - |
    regulator@20704208 {
        compatible = "espressif,esp32s31-ana-i2c";
        reg = <0x20704208 0x4>;
        regulator-name = "ana-i2c";
        regulator-always-on;
    };
...
```

## Documentation/devicetree/bindings/regulator/espressif,esp32s31-gp-ldo.yaml
```yaml
# SPDX-License-Identifier: (GPL-2.0-only OR BSD-2-Clause)
%YAML 1.2
---
$id: http://devicetree.org/schemas/regulator/espressif,esp32s31-gp-ldo.yaml#
$schema: http://devicetree.org/meta-schemas/core.yaml#

title: Espressif ESP32-S31 general-purpose LDO

maintainers:
  - Espressif Linux Port Maintainers <linux-riscv@espressif.com>

allOf:
  - $ref: regulator.yaml#

properties:
  compatible:
    const: espressif,esp32s31-gp-ldo

  reg:
    maxItems: 1

  espressif,ripple-suppression:
    type: boolean

  espressif,current-limit:
    type: boolean

required:
  - compatible
  - reg

unevaluatedProperties: false

examples:
  - |
    regulator@20704218 {
        compatible = "espressif,esp32s31-gp-ldo";
        reg = <0x20704218 0x4>;
        regulator-name = "vdd-psram";
        regulator-min-microvolt = <1800000>;
        regulator-max-microvolt = <1800000>;
        regulator-always-on;
    };
...
```

## Documentation/devicetree/bindings/remoteproc/espressif,esp32s31-lp-core.yaml
```yaml
# SPDX-License-Identifier: (GPL-2.0-only OR BSD-2-Clause)
%YAML 1.2
---
$id: http://devicetree.org/schemas/remoteproc/espressif,esp32s31-lp-core.yaml#
$schema: http://devicetree.org/meta-schemas/core.yaml#

title: Espressif ESP32-S31 low-power core remote processor

maintainers:
  - Espressif Linux Port Maintainers <linux-riscv@espressif.com>

description: |
  LP core brought up through the remoteproc framework. SRAM, mailbox and
  clock-reset windows are loader-reserved; the mailbox interrupt wakes the
  host side, and the PMU reference keeps the shared domain powered.

properties:
  compatible:
    const: espressif,esp32s31-lp-core

  reg:
    maxItems: 5

  reg-names:
    items:
      - const: sram
      - const: mailbox
      - const: lp-sys
      - const: lp-clkrst
      - const: rtc-timer

  interrupts:
    maxItems: 1

  interrupt-names:
    const: mailbox

  firmware-name:
    $ref: /schemas/types.yaml#/definitions/string
    description: Default LP firmware image; the driver falls back to it.

  espressif,pmu:
    $ref: /schemas/types.yaml#/definitions/phandle
    description: PMU controller for the shared power domain.

  clocks:
    maxItems: 1

  clock-names:
    const: cpu

  '#mbox-cells':
    const: 0

required:
  - compatible
  - reg

additionalProperties: false

examples:
  - |
    #include <dt-bindings/interrupt-controller/irq.h>
    #include <dt-bindings/clock/esp32s31-clk.h>
    remoteproc@2e000000 {
        compatible = "espressif,esp32s31-lp-core";
        reg = <0x2e000000 0x8000>, <0x20817000 0x100>,
              <0x20700000 0x100>, <0x20710000 0x100>,
              <0x20800000 0x400>;
        reg-names = "sram", "mailbox", "lp-sys", "lp-clkrst",
                    "rtc-timer";
        interrupts = <139 IRQ_TYPE_LEVEL_HIGH>;
        interrupt-names = "mailbox";
        firmware-name = "esp32s31/s31-lp-core.elf";
        espressif,pmu = <&pmu>;
        clocks = <&clkc ESP32S31_CLK_CPU>;
        clock-names = "cpu";
        #mbox-cells = <0>;
    };
...
```
