## Documentation/devicetree/bindings/cache/espressif,esp32s31-cache.yaml
```yaml
# SPDX-License-Identifier: (GPL-2.0-only OR BSD-2-Clause)
%YAML 1.2
---
$id: http://devicetree.org/schemas/cache/espressif,esp32s31-cache.yaml#
$schema: http://devicetree.org/meta-schemas/core.yaml#

title: Espressif ESP32-S31 external cache controller

maintainers:
  - Espressif Linux Port Maintainers <linux-riscv@espressif.com>

description: |
  External cache controller for flash/PSRAM designation. Cache maintenance
  itself runs through SBI calls; the devicetree node only designates the
  controller window and its instance identifier.

properties:
  compatible:
    const: espressif,esp32s31-cache

  reg:
    maxItems: 1

  espressif,icache-id:
    $ref: /schemas/types.yaml#/definitions/uint32
    description: Cache instance identifier selected by firmware.

required:
  - compatible
  - reg

additionalProperties: false

examples:
  - |
    cache-controller@2c000000 {
        compatible = "espressif,esp32s31-cache";
        reg = <0x2c000000 0x1000>;
        espressif,icache-id = <1>;
    };
...
```

## Documentation/devicetree/bindings/clock/espressif,esp32s31-clk.yaml
```yaml
# SPDX-License-Identifier: (GPL-2.0-only OR BSD-2-Clause)
%YAML 1.2
---
$id: http://devicetree.org/schemas/clock/espressif,esp32s31-clk.yaml#
$schema: http://devicetree.org/meta-schemas/core.yaml#

title: Espressif ESP32-S31 clock and reset controller

maintainers:
  - Espressif Linux Port Maintainers <linux-riscv@espressif.com>

description: |
  The HP clock/reset block contains the boot clock-tree hand-off, peripheral
  source muxes, dividers, gates and reset controls. CPLL, BBPLL and MPLL are
  critical while Linux executes from flash and PSRAM, so the provider exposes
  them read-only.

properties:
  compatible:
    const: espressif,esp32s31-clock

  reg:
    minItems: 5
    maxItems: 5

  reg-names:
    items:
      - const: hp-sys-clkrst
      - const: hp-system
      - const: cnnt-sys
      - const: hp-alive-sys
      - const: lp-aon-clkrst

  '#clock-cells':
    const: 1

  '#reset-cells':
    const: 1

required:
  - compatible
  - reg
  - reg-names
  - '#clock-cells'
  - '#reset-cells'

additionalProperties: false

examples:
  - |
    clock-controller@20587000 {
        compatible = "espressif,esp32s31-clock";
        reg = <0x20587000 0x1000>, <0x20586000 0x1000>,
              <0x20359000 0x1000>, <0x20589000 0x1000>,
              <0x20701000 0x1000>;
        reg-names = "hp-sys-clkrst", "hp-system", "cnnt-sys",
                    "hp-alive-sys", "lp-aon-clkrst";
        #clock-cells = <1>;
        #reset-cells = <1>;
    };
...
```

## Documentation/devicetree/bindings/counter/espressif,esp32s31-gptimer.yaml
```yaml
# SPDX-License-Identifier: (GPL-2.0-only OR BSD-2-Clause)
%YAML 1.2
---
$id: http://devicetree.org/schemas/counter/espressif,esp32s31-gptimer.yaml#
$schema: http://devicetree.org/meta-schemas/core.yaml#

title: Espressif ESP32-S31 timer-group general-purpose timers

maintainers:
  - Espressif Linux Port Maintainers <linux-riscv@espressif.com>

properties:
  compatible:
    const: espressif,esp32s31-gptimer

  reg:
    maxItems: 1

  clocks:
    maxItems: 1

  espressif,reserved-timer-mask:
    $ref: /schemas/types.yaml#/definitions/uint32
    maximum: 3
    description:
      Bit mask of timer channels reserved by firmware and therefore omitted
      from the Linux Counter device. Bit 0 selects timer 0 and bit 1 timer 1.

required:
  - compatible
  - reg
  - clocks

additionalProperties: false
...
```

## Documentation/devicetree/bindings/counter/espressif,esp32s31-pcnt.yaml
```yaml
# SPDX-License-Identifier: (GPL-2.0-only OR BSD-2-Clause)
%YAML 1.2
---
$id: http://devicetree.org/schemas/counter/espressif,esp32s31-pcnt.yaml#
$schema: http://devicetree.org/meta-schemas/core.yaml#

title: Espressif ESP32-S31 pulse counter

maintainers:
  - Espressif Linux Port Maintainers <linux-riscv@espressif.com>

properties:
  compatible:
    const: espressif,esp32s31-pcnt

  reg:
    maxItems: 1

  interrupts:
    maxItems: 1

  clocks:
    maxItems: 1

  resets:
    maxItems: 1

required:
  - compatible
  - reg
  - interrupts
  - clocks

additionalProperties: false

examples:
  - |
    counter@20389000 {
        compatible = "espressif,esp32s31-pcnt";
        reg = <0x20389000 0x100>;
        interrupts = <114 4>;
        clocks = <&clkc 1>;
    };
...
```

## Documentation/devicetree/bindings/crypto/espressif,esp32s31-crypto.yaml
```yaml
# SPDX-License-Identifier: (GPL-2.0-only OR BSD-2-Clause)
%YAML 1.2
---
$id: http://devicetree.org/schemas/crypto/espressif,esp32s31-crypto.yaml#
$schema: http://devicetree.org/meta-schemas/core.yaml#

title: Espressif ESP32-S31 shared crypto accelerators

maintainers:
  - Espressif Linux Port Maintainers <linux-riscv@espressif.com>

description: |
  Native Crypto API provider and owner of the engine locks and clock/reset
  registers shared with the ESP-IDF radio closure. AES and SHA share a DMA
  domain; MPI and ECC are independent. ECDSA, HMAC and digital signing take
  their hardware dependencies through the same provider.

properties:
  compatible:
    const: espressif,esp32s31-crypto

  reg:
    items:
      - description: AES, SHA, MPI, ECC, DS, HMAC and ECDSA registers
      - description: Crypto and Key Manager clock/reset registers
      - description: ECC SRAM power control
      - description: Key Manager registers
      - description: eFuse volatile ECDSA selector and read-reload controls
      - description: Volatile Hardware Unique Key generator and recovery memory

  reg-names:
    items:
      - const: crypto
      - const: clkrst
      - const: ecc-memory
      - const: key-manager
      - const: efuse-read-control
      - const: huk

  rng:
    $ref: /schemas/types.yaml#/definitions/phandle
    description: Conditioned TRNG supplier used by protected-key hardware

  clocks:
    maxItems: 1

  clock-names:
    const: crypto

  interrupts:
    maxItems: 1

  interrupt-names:
    const: ecc

  dmas:
    maxItems: 3
    minItems: 3

  dma-names:
    items:
      - const: sha
      - const: aes-tx
      - const: aes-rx

  nvmem-cells:
    items:
      - description: Five packed five-bit key purposes in eFuse BLK0 bits 96..120
      - description: Read-protection flags in eFuse BLK0 bits 32..63

  nvmem-cell-names:
    items:
      - const: key-purposes
      - const: key-read-protect

required:
  - compatible
  - reg
  - reg-names
  - clocks
  - clock-names
  - interrupts
  - interrupt-names
  - rng
  - nvmem-cells
  - nvmem-cell-names

additionalProperties: false
...
```

## Documentation/devicetree/bindings/dma/espressif,esp32s31-ahb-gdma.yaml
```yaml
# SPDX-License-Identifier: (GPL-2.0-only OR BSD-2-Clause)
%YAML 1.2
---
$id: http://devicetree.org/schemas/dma/espressif,esp32s31-ahb-gdma.yaml#
$schema: http://devicetree.org/meta-schemas/core.yaml#

title: Espressif ESP32-S31 AHB GDMA controller

maintainers:
  - Espressif Linux Port Maintainers <linux-riscv@espressif.com>

description: |
  AHB GDMA engine with five RX and five TX channels. The second register
  window is the descriptor pool in loader-reserved HP SRAM.

properties:
  compatible:
    const: espressif,esp32s31-ahb-gdma

  reg:
    maxItems: 2

  reg-names:
    items:
      - const: dma
      - const: descriptors

  clocks:
    maxItems: 1

  resets:
    maxItems: 1

  interrupts:
    maxItems: 10

  interrupt-names:
    items:
      - const: rx0
      - const: rx1
      - const: rx2
      - const: rx3
      - const: rx4
      - const: tx0
      - const: tx1
      - const: tx2
      - const: tx3
      - const: tx4

  '#dma-cells':
    const: 2

  dma-channels:
    const: 5

required:
  - compatible
  - reg

additionalProperties: false

examples:
  - |
    #include <dt-bindings/interrupt-controller/irq.h>
    #include <dt-bindings/clock/esp32s31-clk.h>
    dma-controller@20343000 {
        compatible = "espressif,esp32s31-ahb-gdma";
        reg = <0x20343000 0x628>, <0x2f075380 0x1000>;
        reg-names = "dma", "descriptors";
        clocks = <&clkc ESP32S31_CLK_AHB_GDMA>;
        resets = <&clkc ESP32S31_RST_AHB_GDMA>;
        interrupts = <36 IRQ_TYPE_LEVEL_HIGH>,
                     <37 IRQ_TYPE_LEVEL_HIGH>,
                     <38 IRQ_TYPE_LEVEL_HIGH>,
                     <39 IRQ_TYPE_LEVEL_HIGH>,
                     <40 IRQ_TYPE_LEVEL_HIGH>,
                     <41 IRQ_TYPE_LEVEL_HIGH>,
                     <42 IRQ_TYPE_LEVEL_HIGH>,
                     <43 IRQ_TYPE_LEVEL_HIGH>,
                     <44 IRQ_TYPE_LEVEL_HIGH>,
                     <45 IRQ_TYPE_LEVEL_HIGH>;
        interrupt-names = "rx0", "rx1", "rx2", "rx3", "rx4",
                          "tx0", "tx1", "tx2", "tx3", "tx4";
        #dma-cells = <2>;
        dma-channels = <5>;
    };
...
```

## Documentation/devicetree/bindings/dma/espressif,esp32s31-axi-gdma.yaml
```yaml
# SPDX-License-Identifier: (GPL-2.0-only OR BSD-2-Clause)
%YAML 1.2
---
$id: http://devicetree.org/schemas/dma/espressif,esp32s31-axi-gdma.yaml#
$schema: http://devicetree.org/meta-schemas/core.yaml#

title: Espressif ESP32-S31 AXI GDMA controller

maintainers:
  - Espressif Linux Port Maintainers <linux-riscv@espressif.com>

description: |
  AXI GDMA engine with three RX and three TX channels. The second register
  window is the 12 KiB descriptor pool in loader-reserved HP SRAM. The pair
  index is the first DMA specifier cell (0..2, or 0xffffffff to borrow any
  free pair). The second cell selects the peripheral trigger (LCD=0 .. SHA=5).

properties:
  compatible:
    const: espressif,esp32s31-axi-gdma

  reg:
    minItems: 2
    maxItems: 2

  reg-names:
    items:
      - const: dma
      - const: descriptors

  clocks:
    maxItems: 1

  resets:
    maxItems: 1

  interrupts:
    minItems: 6
    maxItems: 6

  interrupt-names:
    items:
      - const: rx0
      - const: rx1
      - const: rx2
      - const: tx0
      - const: tx1
      - const: tx2

  '#dma-cells':
    const: 2

  dma-channels:
    const: 3

required:
  - compatible
  - reg
  - reg-names
  - clocks
  - resets
  - interrupts
  - interrupt-names
  - '#dma-cells'

additionalProperties: false

examples:
  - |
    #include <dt-bindings/interrupt-controller/irq.h>
    dma-controller@20348000 {
        compatible = "espressif,esp32s31-axi-gdma";
        reg = <0x20348000 0x1000>, <0x2f072380 0x3000>;
        reg-names = "dma", "descriptors";
        clocks = <&clkc 54>;
        resets = <&clkc 27>;
        interrupts = <48 IRQ_TYPE_LEVEL_HIGH>,
                     <49 IRQ_TYPE_LEVEL_HIGH>,
                     <50 IRQ_TYPE_LEVEL_HIGH>,
                     <51 IRQ_TYPE_LEVEL_HIGH>,
                     <52 IRQ_TYPE_LEVEL_HIGH>,
                     <53 IRQ_TYPE_LEVEL_HIGH>;
        interrupt-names = "rx0", "rx1", "rx2",
                          "tx0", "tx1", "tx2";
        #dma-cells = <2>;
        dma-channels = <3>;
    };
...
```

## Documentation/devicetree/bindings/dma/espressif,esp32s31-dma2d.yaml
```yaml
# SPDX-License-Identifier: (GPL-2.0-only OR BSD-2-Clause)
%YAML 1.2
---
$id: http://devicetree.org/schemas/dma/espressif,esp32s31-dma2d.yaml#
$schema: http://devicetree.org/meta-schemas/core.yaml#

title: Espressif ESP32-S31 two-dimensional image DMA

maintainers:
  - GrieferPig <grieferpig@163.com>

allOf:
  - $ref: dma-controller.yaml#

properties:
  compatible:
    enum:
      - espressif,esp32s31-dma2d
  reg:
    minItems: 3
    maxItems: 3
  clocks:
    maxItems: 1
  resets:
    maxItems: 1
  reg-names:
    items:
      - const: dma
      - const: descriptors
      - const: memory-power
  interrupts:
    minItems: 3
    maxItems: 3
  interrupt-names:
    items:
      - const: rx
      - const: tx
      - const: foreground
  '#dma-cells':
    const: 1
    description: Only virtual copy channel 0 is exposed; image clients use the supplier phandle.
  dma-channels:
    const: 1

required:
  - compatible
  - reg
  - clocks
  - resets
  - reg-names
  - interrupts
  - interrupt-names
  - "#dma-cells"
additionalProperties: false
...
```

## Documentation/devicetree/bindings/firmware/opensbi,config.yaml
```yaml
# SPDX-License-Identifier: (GPL-2.0-only OR BSD-2-Clause)
%YAML 1.2
---
$id: http://devicetree.org/schemas/firmware/opensbi,config.yaml#
$schema: http://devicetree.org/meta-schemas/core.yaml#
title: OpenSBI runtime configuration
maintainers:
  - S31 Linux contributors <s31-linux@localhost>
description: Firmware configuration child of /chosen consumed during OpenSBI initialization.
properties:
  compatible:
    const: opensbi,config
  heap-size:
    $ref: /schemas/types.yaml#/definitions/uint32
    minimum: 4096
    description: OpenSBI heap size in bytes.
required:
  - compatible
additionalProperties: false
```

## Documentation/devicetree/bindings/hwmon/espressif,esp32s31-tsens.yaml
```yaml
# SPDX-License-Identifier: (GPL-2.0-only OR BSD-2-Clause)
%YAML 1.2
---
$id: http://devicetree.org/schemas/hwmon/espressif,esp32s31-tsens.yaml#
$schema: http://devicetree.org/meta-schemas/core.yaml#

title: Espressif ESP32-S31 on-chip temperature sensor

maintainers:
  - Espressif Linux Port Maintainers <linux-riscv@espressif.com>

properties:
  compatible:
    const: espressif,esp32s31-tsens

  reg:
    items:
      - description: Temperature sensor register block
      - description: LP temperature sensor clock and reset register

  reg-names:
    items:
      - const: tsens
      - const: clkrst

  interrupts:
    maxItems: 1

  analog-supply:
    description: Shared analog register-I2C power switch.

required:
  - compatible
  - reg
  - reg-names
  - interrupts
  - analog-supply

additionalProperties: false

examples:
  - |
    temperature-sensor@20818000 {
        compatible = "espressif,esp32s31-tsens";
        reg = <0x20818000 0x2c>, <0x20710030 0x4>;
        reg-names = "tsens", "clkrst";
        interrupts = <150 4>;
    };
...
```

## Documentation/devicetree/bindings/i2c/espressif,esp32s31-i2c.yaml
```yaml
# SPDX-License-Identifier: (GPL-2.0-only OR BSD-2-Clause)
%YAML 1.2
---
$id: http://devicetree.org/schemas/i2c/espressif,esp32s31-i2c.yaml#
$schema: http://devicetree.org/meta-schemas/core.yaml#

title: Espressif ESP32-S31 high-performance I2C controller

maintainers:
  - GrieferPig <noreply@example.com>

allOf:
  - $ref: /schemas/i2c/i2c-controller.yaml#

properties:
  compatible:
    const: espressif,esp32s31-i2c

  reg:
    maxItems: 1

  interrupts:
    maxItems: 1

  clocks:
    maxItems: 1

  resets:
    maxItems: 1

  espressif,param-name:
    $ref: /schemas/types.yaml#/definitions/string
    description: Property exposed by the overlay tool as a configurable scalar.
    const: clock-frequency

  espressif,param-values:
    $ref: /schemas/types.yaml#/definitions/uint32-array
    description: Allowed clock frequencies for the overlay tool.
    minItems: 1
    maxItems: 3

  clock-frequency:
    default: 100000
    minimum: 50000
    maximum: 1000000

required:
  - compatible
  - reg
  - interrupts
  - clocks
  - '#address-cells'
  - '#size-cells'

unevaluatedProperties: false

examples:
  - |
    i2c@20385000 {
        compatible = "espressif,esp32s31-i2c";
        reg = <0x20385000 0x200>;
        interrupts = <23 4>;
        clocks = <&clkc 25>;
        clock-frequency = <100000>;
        #address-cells = <1>;
        #size-cells = <0>;
    };
```
