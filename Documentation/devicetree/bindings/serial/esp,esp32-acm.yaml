## Documentation/devicetree/bindings/serial/esp,esp32-acm.yaml
```yaml
# SPDX-License-Identifier: GPL-2.0-only OR BSD-2-Clause

%YAML 1.2
---
$id: http://devicetree.org/schemas/serial/esp,esp32-acm.yaml#
$schema: http://devicetree.org/meta-schemas/core.yaml#

title: Espressif fixed-function USB Serial/JTAG controller

maintainers:
  - Max Filippov <jcmvbkbc@gmail.com>

description:
  Fixed-function USB CDC-ACM gadget controller of the Espressif ESP32-S3 and
  ESP32-S31 SoCs. The ESP32-S31 instance resides in the shared HPCNNT power
  domain.

allOf:
  - $ref: serial.yaml#

properties:
  compatible:
    enum:
      - esp,esp32s3-acm
      - espressif,esp32s31-usb-serial-jtag

  reg:
    maxItems: 1

  interrupts:
    maxItems: 1

  power-domains:
    maxItems: 1

required:
  - compatible
  - reg
  - interrupts

additionalProperties: false

examples:
  - |
    serial@60038000 {
      compatible = "esp,esp32s3-acm";
      reg = <0x60038000 0x1000>;
      interrupts = <96 3 0>;
    };
```

## Documentation/devicetree/bindings/sound/espressif,esp32s31-i2s.yaml
```yaml
# SPDX-License-Identifier: (GPL-2.0-only OR BSD-2-Clause)
%YAML 1.2
---
$id: http://devicetree.org/schemas/sound/espressif,esp32s31-i2s.yaml#
$schema: http://devicetree.org/meta-schemas/core.yaml#

title: Espressif ESP32-S31 I2S and TDM controller

maintainers:
  - Espressif Linux Port Maintainers <linux-riscv@espressif.com>

properties:
  compatible:
    const: espressif,esp32s31-i2s

  reg:
    maxItems: 1

  clocks:
    maxItems: 1

  resets:
    maxItems: 1

  "#sound-dai-cells":
    const: 0

  espressif,external-card:
    type: boolean
    description: |
      Register only the CPU DAI and DMA PCM component. A separate machine
      driver, for example simple-audio-card, supplies the codec and link
      format. Without this property the standalone dummy-codec card is used.

  espressif,tx-slave:
    type: boolean
    description: |
      Use external TX BCLK and WS for the standalone card. An external
      machine driver's set_fmt operation overrides both direction roles.

  dmas:
    minItems: 2
    maxItems: 2

  dma-names:
    items:
      - const: tx
      - const: rx

  espressif,tx-pdm:
    type: boolean
    description: Select raw PDM framing for the transmit unit.

  espressif,rx-pdm:
    type: boolean
    description: Select raw PDM framing for the receive unit.

  espressif,loopback:
    type: boolean

required:
  - compatible
  - reg
  - clocks
  - dmas
  - dma-names

additionalProperties: true
...
```

## Documentation/devicetree/bindings/spi/espressif,esp32s31-gpspi.yaml
```yaml
# SPDX-License-Identifier: (GPL-2.0-only OR BSD-2-Clause)
%YAML 1.2
---
$id: http://devicetree.org/schemas/spi/espressif,esp32s31-gpspi.yaml#
$schema: http://devicetree.org/meta-schemas/core.yaml#

title: Espressif ESP32-S31 general-purpose SPI controller

maintainers:
  - Espressif Linux Port Maintainers <linux-riscv@espressif.com>

description: |
  The controller can switch between host and target through runtime overlays.
  Target mode keeps the base tree's address-cell count; changing it on a live
  node is rejected by OF overlay. The target child has no reg property.

allOf:
  - $ref: spi-controller.yaml#

properties:
  compatible:
    const: espressif,esp32s31-gpspi

  reg:
    maxItems: 1

  interrupts:
    maxItems: 1

  clocks:
    maxItems: 1

  resets:
    maxItems: 1

  dmas:
    minItems: 2
    maxItems: 2

  dma-names:
    items:
      - const: tx
      - const: rx

  espressif,gpio-cs-drive-strength:
    $ref: /schemas/types.yaml#/definitions/uint32
    description: GPIO chip-select pad drive strength in mA.
    enum: [5, 10, 20, 40]

  espressif,max-data-lines:
    $ref: /schemas/types.yaml#/definitions/uint32
    description: Maximum controller data bus width.
    enum: [4, 8]

required:
  - compatible
  - reg
  - interrupts
  - clocks

unevaluatedProperties: false
...
```

## Documentation/devicetree/bindings/spi/rohm,dh2228fv.yaml
```yaml
# SPDX-License-Identifier: (GPL-2.0-only OR BSD-2-Clause)
%YAML 1.2
---
$id: http://devicetree.org/schemas/spi/rohm,dh2228fv.yaml#
$schema: http://devicetree.org/meta-schemas/core.yaml#
title: SPI test endpoint used by the S31 peripheral fixture
maintainers:
  - S31 Linux contributors <s31-linux@localhost>
description: Existing spidev-compatible controller and target diagnostic endpoint.
allOf:
  - $ref: spi-peripheral-props.yaml#
  - if:
      properties:
        $nodename:
          const: slave
    then:
      properties:
        reg: false
    else:
      required:
        - reg
properties:
  compatible:
    const: rohm,dh2228fv
  reg:
    maxItems: 1
required:
  - compatible
unevaluatedProperties: false
```

## arch/riscv/Kconfig.socs
```kconfig
menu "SoC selection"

config ARCH_ANDES
	bool "Andes SoCs"
	depends on MMU && !XIP_KERNEL
	select ERRATA_ANDES
	help
	  This enables support for Andes SoC platform hardware.

config ARCH_ESWIN
	bool "ESWIN SoCs"
	help
	  This enables support for ESWIN SoC platform hardware,
	  including the ESWIN EIC7700 SoC.

config ARCH_MICROCHIP_POLARFIRE
	def_bool ARCH_MICROCHIP

config ARCH_MICROCHIP
	bool "Microchip SoCs"
	help
	  This enables support for Microchip SoC platforms.

config ARCH_RENESAS
	bool "Renesas RISC-V SoCs"
	help
	  This enables support for the RISC-V based Renesas SoCs.

config ARCH_SIFIVE
	bool "SiFive SoCs"
	select ERRATA_SIFIVE if !XIP_KERNEL
	help
	  This enables support for SiFive SoC platform hardware.

config ARCH_SOPHGO
	bool "Sophgo SoCs"
	help
	  This enables support for Sophgo SoC platform hardware.

config ARCH_SPACEMIT
	bool "SpacemiT SoCs"
	select PINCTRL
	help
	  This enables support for SpacemiT SoC platform hardware.

config ARCH_STARFIVE
	def_bool SOC_STARFIVE

config SOC_STARFIVE
	bool "StarFive SoCs"
	select PINCTRL
	select RESET_CONTROLLER
	select ARM_AMBA
	help
	  This enables support for StarFive SoC platform hardware.

config ARCH_SUNXI
	bool "Allwinner sun20i SoCs"
	depends on MMU && !XIP_KERNEL
	select ERRATA_THEAD
	select SUN4I_TIMER
	help
	  This enables support for Allwinner sun20i platform hardware,
	  including boards based on the D1 and D1s SoCs.

config ARCH_THEAD
	bool "T-HEAD RISC-V SoCs"
	depends on MMU && !XIP_KERNEL
	select ERRATA_THEAD
	select PM_GENERIC_DOMAINS if PM
	help
	  This enables support for the RISC-V based T-HEAD SoCs.

config ARCH_VIRT
	bool "QEMU Virt Machine"
	select POWER_RESET
	select POWER_RESET_SYSCON
	select POWER_RESET_SYSCON_POWEROFF
	select GOLDFISH
	select RTC_DRV_GOLDFISH if RTC_CLASS
	select PM_GENERIC_DOMAINS if PM
	select PM_GENERIC_DOMAINS_OF if PM && OF
	select RISCV_SBI_CPUIDLE if CPU_IDLE && RISCV_SBI
	help
	  This enables support for QEMU Virt Machine.

config ARCH_CANAAN
	bool "Canaan Kendryte SoC"
	help
	  This enables support for Canaan Kendryte series SoC platform hardware.

config SOC_CANAAN_K210
	bool "Canaan Kendryte K210 SoC"
	depends on !MMU && ARCH_CANAAN
	select ARCH_HAS_RESET_CONTROLLER
	select PINCTRL
	select COMMON_CLK
	help
	  This enables support for Canaan Kendryte K210 SoC platform hardware.

config ARCH_ESPRESSIF
	bool "Espressif RISC-V SoCs"
	help
	  This enables support for Espressif RISC-V SoCs.

config SOC_ESP32S31
	bool "Espressif ESP32-S31 SoC"
	depends on ARCH_ESPRESSIF
	select ESP32S31_CLIC
	help
	  This enables support for the Espressif ESP32-S31 SoC.
	  With MMU enabled the kernel runs in Supervisor mode behind OpenSBI.

config ESP32S31_COPROC_CONTEXT
	bool "ESP32-S31 HWLoop/PIE task context through SBI"
	depends on SOC_ESP32S31
	help
	  Save and restore the stateful HWLoop and PIE extensions on task
	  switches, fork and signal delivery.  The extension state CSRs are
	  M-mode-only, so this requires a synchronous SBI ecall on every context
	  switch.  OpenSBI strips M-CLIC metadata when redirecting traps so an
	  ecall cannot restore the cross-privilege SIL=0xff sentinel into S-mode.
	  PIE state is saved only on hart 1; users of XespV must stay CPU1-bound.

config ESP32S31_RADIO_SCHEDULER
	bool "ESP32-S31 explicit radio scheduling admission"
	depends on SOC_ESP32S31 && SMP && ESP32S31_COPROC_CONTEXT && FPU
	depends on RT_MUTEXES && PREEMPTION
	default n
	help
	  Permit an owner to admit a dormant fixed-CPU0 radio kthread. Its
	  scheduler role is not inherited by fork. An actually selected admitted
	  RT task, or its top-PI dependency, may precede the deadline fair server;
	  real deadline tasks and ordinary RT reservations retain their policy.
	  This does not bypass configured RT-group quotas, make cache-off code
	  preemptible, or authorize a vendor callback in an unsafe IRQ context.

config ESP32S31_RADIO_SMODE
	bool "ESP32-S31 S-mode radio runtime"
	depends on SOC_ESP32S31 && MMU && 32BIT && !RISCV_M_MODE
	select IRQ_STACKS
	help
	  Support native ESP32-S31 radio tasks in supervisor mode, including
	  registered SRAM stacks and canonical sscratch thread identity at traps
	  and firmware imports. Immutable peripheral/cache/SRAM/ROM supervisor
	  leaves are shared by every address space. Native radio IRQ execution
	  leases CPU0's independent Linux IRQ stack in internal SRAM.

endmenu # "SoC selection"
```

## drivers/cache/Kconfig
```kconfig
# SPDX-License-Identifier: GPL-2.0
menu "Cache Drivers"

config ESP32S31_CACHE
	bool "Espressif ESP32-S31 external-memory cache controller"
	depends on SOC_ESP32S31
	default y
	select RISCV_DMA_NONCOHERENT
	select RISCV_NONSTANDARD_CACHE_OPS
	help
	  Support the ESP32-S31 cache synchronization engine used for the
	  cached flash and PSRAM windows. This also supplies the non-coherent
	  DMA cache operations required when devices access PSRAM directly.

config AX45MP_L2_CACHE
	bool "Andes Technology AX45MP L2 Cache controller"
	depends on RISCV
	select RISCV_NONSTANDARD_CACHE_OPS
	help
	  Support for the L2 cache controller on Andes Technology AX45MP platforms.

config SIFIVE_CCACHE
	bool "Sifive Composable Cache controller"
	depends on ARCH_SIFIVE || ARCH_STARFIVE
	help
	  Support for the composable cache controller on SiFive platforms.

config STARFIVE_STARLINK_CACHE
	bool "StarFive StarLink Cache controller"
	depends on RISCV
	depends on ARCH_STARFIVE
	depends on 64BIT
	select RISCV_DMA_NONCOHERENT
	select RISCV_NONSTANDARD_CACHE_OPS
	help
	  Support for the StarLink cache controller IP from StarFive.

endmenu
```

## drivers/cpuidle/Kconfig.riscv
```kconfig
# SPDX-License-Identifier: GPL-2.0-only
#
# RISC-V CPU Idle drivers
#

config RISCV_SBI_CPUIDLE
	bool "RISC-V SBI CPU idle Driver"
	depends on RISCV_SBI
	select DT_IDLE_STATES
	select CPU_IDLE_MULTIPLE_DRIVERS
	select DT_IDLE_GENPD if PM_GENERIC_DOMAINS_OF
	help
	  Select this option to enable RISC-V SBI firmware based CPU idle
	  driver for RISC-V systems. This drivers also supports hierarchical
	  DT based layout of the idle state.

config ESP32S31_CPUIDLE
	bool "ESP32-S31 OpenSBI CPU idle"
	depends on SOC_ESP32S31 && RISCV_SBI
	default y
	help
	  Enter WFI through the ESP32-S31 OpenSBI CLIC service. Each hart uses
	  its own SYSTIMER comparator as a bounded wake source, avoiding the
	  shared CLINT alias while allowing both harts to idle concurrently.
```

## drivers/media/platform/espressif/Kconfig
```kconfig
# SPDX-License-Identifier: GPL-2.0-only
config VIDEO_ESP32S31
 tristate "ESP32-S31 JPEG and PPA memory engines"
 depends on SOC_ESP32S31 && OF && VIDEO_DEV && ESP32S31_DMA2D
 select VIDEOBUF2_DMA_CONTIG
 select V4L2_MEM2MEM_DEV
 select V4L2_JPEG_HELPER
 select MEDIA_CONTROLLER
 select VIDEO_V4L2_SUBDEV_API
 help
   Standard V4L2 memory-to-memory JPEG encode/decode and PPA image
   scaling, rotation, mirroring, blending and color conversion. No camera or
   display is needed. Frame buffers are allocated on request.
```

## drivers/net/ethernet/espressif/Kconfig
```kconfig
# SPDX-License-Identifier: GPL-2.0-only

config ESP32S31_HOSTED_SRAM
	bool "ESP32-S31 in-package ESP-Hosted SRAM transport"
	depends on SOC_ESP32S31
	depends on NET
	select BT
	select CRC32
	help
	  Expose the Wi-Fi radio firmware running on hart0 as an Ethernet
	  interface on hart1.  Frames and Bluetooth HCI packets are transported
	  through a pair of lockless rings in reserved HP SRAM.
```

## drivers/net/wireless/espressif/Kconfig
```kconfig
# SPDX-License-Identifier: GPL-2.0-only

config WLAN_VENDOR_ESPRESSIF
	bool "Espressif wireless devices"
	default y

if WLAN_VENDOR_ESPRESSIF

config ESP32S31_WIFI
	bool
	default y if ESP32S31_RADIO_SMODE_DRIVER

endif
```

## drivers/platform/Kconfig
```kconfig
# SPDX-License-Identifier: GPL-2.0-only

config ESP32S31_DT_OVERLAY
	bool "ESP32-S31 transactional Device Tree overlay manager"
	depends on SOC_ESP32S31
	select OF_OVERLAY
	help
	  Exposes /dev/s31-overlay. A complete DTBO written to the device
	  replaces the currently active overlay. Replacement is transactional:
	  the previous overlay is restored if applying the new one fails.

config ESP32S31_RADIO_SMODE_DRIVER
	tristate "ESP32-S31 S-mode radio runtime"
	depends on ESP32S31_RADIO_SMODE
	depends on ESP32S31_COPROC_CONTEXT && FPU
	depends on SMP && PREEMPTION
	depends on BT && WLAN
	select FUTEX
	select CRYPTO_DEV_ESP32S31
	select RT_MUTEXES
	select ESP32S31_RADIO_SCHEDULER
	select CFG80211
	help
	  Build the reloadable esp32s31-radio.ko. It owns the shared PHY, SRAM,
	  clocks and interrupts and exposes cfg80211 plus direct HCI from one
	  module. mode=wifi, mode=bt, or mode=combo selects the runtime profile.
	  Native persistent contexts, PI mutexes and radio scheduling are
	  mandatory; no legacy execution backend is provided. The prelinked
	  ESP-IDF closure runs from its fixed flash-XIP slot.

config ESP32S31_WIFI_SOFTMAC
	bool
	depends on ESP32S31_RADIO_SMODE_DRIVER && MAC80211
	default y
	help
	  Native mac80211 frontend on the simplified Linux radio runtime.

config ESP32S31_RADIO_XIP
	bool
	depends on SOC_ESP32S31 && XIP_KERNEL && 32BIT
	select CRC32
	default y
	help
	  Fixed executable flash mapping and 40 KiB writable SRAM arena.
	  The radio image and Linux module must be built together.

config ESP32S31_RADIO_BLOBS
	bool
	depends on ESP32S31_RADIO_SMODE_DRIVER
	default y

source "drivers/platform/mips/Kconfig"

source "drivers/platform/loongarch/Kconfig"

source "drivers/platform/goldfish/Kconfig"

source "drivers/platform/chrome/Kconfig"

source "drivers/platform/cznic/Kconfig"

source "drivers/platform/mellanox/Kconfig"

source "drivers/platform/olpc/Kconfig"

source "drivers/platform/surface/Kconfig"

source "drivers/platform/x86/Kconfig"

source "drivers/platform/arm64/Kconfig"
```

## drivers/pmdomain/Kconfig
```kconfig
# SPDX-License-Identifier: GPL-2.0-only
menu "PM Domains"

config ESP32S31_PMU
	bool "Espressif ESP32-S31 power domains"
	depends on SOC_ESP32S31 && PM && OF
	select PM_GENERIC_DOMAINS
	help
	  Register the ESP32-S31 PMU domains. CPU, flash/PSRAM and radio-owned
	  domains remain on; HPCNNT runtime power-off is guarded by an explicit
	  Device Tree opt-in until every connectivity consumer supports runtime PM.

source "drivers/pmdomain/actions/Kconfig"
source "drivers/pmdomain/amlogic/Kconfig"
source "drivers/pmdomain/apple/Kconfig"
source "drivers/pmdomain/arm/Kconfig"
source "drivers/pmdomain/bcm/Kconfig"
source "drivers/pmdomain/imx/Kconfig"
source "drivers/pmdomain/marvell/Kconfig"
source "drivers/pmdomain/mediatek/Kconfig"
source "drivers/pmdomain/qcom/Kconfig"
source "drivers/pmdomain/renesas/Kconfig"
source "drivers/pmdomain/rockchip/Kconfig"
source "drivers/pmdomain/samsung/Kconfig"
source "drivers/pmdomain/st/Kconfig"
source "drivers/pmdomain/starfive/Kconfig"
source "drivers/pmdomain/sunxi/Kconfig"
source "drivers/pmdomain/tegra/Kconfig"
source "drivers/pmdomain/thead/Kconfig"
source "drivers/pmdomain/ti/Kconfig"
source "drivers/pmdomain/xilinx/Kconfig"

endmenu
```
